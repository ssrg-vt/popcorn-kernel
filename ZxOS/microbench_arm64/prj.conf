## prj.conf
```kconfig
CONFIG_STACK_CANARIES=n
CONFIG_INIT_STACKS=y
CONFIG_USERSPACE=y
#CONFIG_ZTEST=y
CONFIG_TEST_USERSPACE=y

#CONFIG_PCIE=y
#CONFIG_PCIE_MSI=y
#CONFIG_PCIE_MSI_X=y
#CONFIG_PCIE_MSI_MULTI_VECTOR=y

#CONFIG_VIRTUALIZATION=y
#CONFIG_IVSHMEM=y
```

## src/app.c
```c
#include <zephyr.h>
#include <drivers/virtualization/ivshmem.h>
#include <stdio.h>
#include <pthread.h>


#define STACKSIZ ((8192 *2) + CONFIG_TEST_EXTRA_STACKSIZE)

K_THREAD_STACK_ARRAY_DEFINE(blasch_stacks, 1 , STACKSIZ);

extern int bs_thread(void *tid_ptr);

#define MAX_THREADS 128
extern int _M4_threadsTableAllocated[MAX_THREADS];
enum request_type{
        COMPUTE_VRANLC,
        COMPUTE_RANDLC,
        COMPUTE_LOG,
	RESPOND_VRANLC,
	BLACKSCHOLES_REQ

};
enum arg_type {
        CHAR,
        CHAR_P,
        DOUBLE,
        DOUBLE_P,
	INT

};
struct argument {
        uint32_t * location;
        uint32_t size;
        enum arg_type type;
};



struct offload_struct{
        uint32_t new_request ;
	enum request_type type;
        struct argument args[8];
};
struct handshake
{
        uint32_t present;
        char arch[10];
};
struct shared_area
{
        volatile void * write_area;
        volatile void * read_area;
};
  typedef struct {
      unsigned int mantissa_low:32;     
      unsigned int mantissa_high:20;
      unsigned int exponent:11;        
      unsigned int sign:1;
    } tDoubleStruct;
int tid;



void vranlc( int n, double *x, double a, double y[] )
{
  const double r23 = 1.1920928955078125e-07;
  const double r46 = r23 * r23;
  const double t23 = 8.388608e+06;
  const double t46 = t23 * t23;

  double t1, t2, t3, t4, a1, a2, x1, x2, z;

  int i;

  //--------------------------------------------------------------------
  //  Break A into two parts such that A = 2^23 * A1 + A2.
  //--------------------------------------------------------------------
  t1 = r23 * a;
  a1 = (int) t1;
  a2 = a - t23 * a1;

  //--------------------------------------------------------------------
  //  Generate N results.   This loop is not vectorizable.
  //--------------------------------------------------------------------
  for ( i = 0; i < n; i++ ) {
    //--------------------------------------------------------------------
    //  Break X into two parts such that X = 2^23 * X1 + X2, compute
    //  Z = A1 * X2 + A2 * X1  (mod 2^23), and then
    //  X = 2^23 * Z + A2 * X2  (mod 2^46).
    //--------------------------------------------------------------------
    t1 = r23 * (*x);
    x1 = (int) t1;
    x2 = *x - t23 * x1;
    t1 = a1 * x2 + a2 * x1;
    t2 = (int) (r23 * t1);
    z = t1 - t23 * t2;
    t3 = t23 * z + a2 * x2;
    t4 = (int) (r46 * t3) ;
    *x = t3 - t46 * t4;
    y[1] = r46 * (*x);
  }

  return;
}


void main()
{
	printf("arm64 app started\n");
	volatile struct shared_area rw_buf = {
                .write_area = (void*)0x9f000000,
                .read_area  = (void*)0x90000000
        };
	*((uint32_t*)rw_buf.write_area) = 0x00000000 ;
	struct handshake hnsk = {
                .present = 0xE00E0EE0,
        };
	struct handshake in_hnsk;
	memcpy(hnsk.arch, "ARM",4);
	memcpy((void*)&in_hnsk,rw_buf.read_area,sizeof(struct shared_area)); 	
	if(in_hnsk.present  == 0x1FF1F11F)
        {
        	printf("Already other core %s present in memory.\n",in_hnsk.arch);
		memcpy(rw_buf.write_area,(void*)&hnsk,sizeof(struct shared_area));
	}
	else{
                printf("Attempting connection with other core ::\n");
                 static uint64_t l = 0;
		while(1)
                {
                        volatile struct handshake * other = (struct handshake*)rw_buf.read_area;
			if(other->present == 0x1FF1F11F)
			{
                                printf("Other core of type x86 now conected \n");
                        	break;
			}
			else
			{
				if(l % 9000000 == 0){
                                        printf("waiting for other core\n");
                        		memcpy((void*)rw_buf.write_area,(void*)&hnsk,sizeof(struct shared_area));
				}
                                l++;
			}
                }
        }
	blackscholes_main();
	while(1)
	{
		struct offload_struct *  inp = (struct offload_struct *)rw_buf.read_area ;
		if(inp->new_request == 0xF00F0FF0)
		{
		   if(inp->type == COMPUTE_VRANLC)	{	
			printf("A request of type COMPUTE_VRANLC came\n");
			printf("Args are %d , %f , %f and %f\n", *inp->args[0].location,*(double*)inp->args[1].location,*(double*)inp->args[2].location,*(double*)inp->args[3].location);
			vranlc(*(int*)inp->args[0].location,(double*)inp->args[1].location,*(double*)inp->args[2].location , (double*)inp->args[3].location);
			printf("Post computation value of y is %f and value of x is %f\n",*((double*)inp->args[3].location), *((double*)inp->args[1].location));			
			
			//indicate that you have consumed the message
			*(uint32_t*)inp = ~(0xF00F0FF0);

			//Start replying
			struct offload_struct ofld_vranlc ;

			ofld_vranlc.new_request = 0xF00F0FF0;
			void * write_pointer = (void*)((char*)rw_buf.write_area + 0x1000);
			
			*((int*)write_pointer)  = *(int*)inp->args[0].location;
		        ofld_vranlc.args[0].location =  (uint32_t*)((char*)write_pointer - 0x40000000);
        		printf("Location of the int is %p\n",ofld_vranlc.args[0].location);
      			write_pointer =  (void*)((char*)write_pointer +  sizeof(int));

        		*((double*)write_pointer) = *(int*)inp->args[1].location;
        		ofld_vranlc.args[1].location =  (uint32_t*)((char*)write_pointer - 0x40000000) ;
        		printf("Location of the float pointer is %p\n",ofld_vranlc.args[1].location);
        		write_pointer  =  (void*)((char*)write_pointer +  sizeof(double));

        		*((double*)write_pointer) = *(int*)inp->args[2].location;
        		ofld_vranlc.args[2].location =  (uint32_t*)((char*)write_pointer - 0x40000000) ;
        		write_pointer  =  (void*)((char*)write_pointer +  sizeof(double));

        		*((double*)write_pointer) = *(int*)inp->args[3].location;
        		ofld_vranlc.args[3].location = (uint32_t*)((char*)write_pointer - 0x40000000)   ;


        		ofld_vranlc.type = RESPOND_VRANLC;
        		ofld_vranlc.args[0].size = 1;
        		ofld_vranlc.args[0].type = INT;
        		ofld_vranlc.args[1].size = 1;
			ofld_vranlc.args[1].type = DOUBLE;
        		ofld_vranlc.args[2].size = 1;
        		ofld_vranlc.args[2].type = DOUBLE;
        		ofld_vranlc.args[3].size = 1;
        		ofld_vranlc.args[3].type = DOUBLE;

        		memcpy((void*)rw_buf.write_area , (void*)&ofld_vranlc , sizeof(struct offload_struct) );				

		   }
		  else if(inp->type == BLACKSCHOLES_REQ)	{	
			printf("A request of type BLACKSCHOLES_REQ came\n");
			printf("Locations are %x , %x , %x and %x\n", (void*)inp->args[0].location);
			printf("values needed only arg 4 %d\n",*(int*)inp->args[0].location);
				
			//do the work here
			pthread_attr_t attr;
			pthread_t threadid;
			pthread_attr_init(&attr);
			pthread_attr_setstack(&attr, &blasch_stacks[0], STACKSIZ);
//			pthread_create(&threadid,&attr,(void *(*)(void *))bs_thread,(void *)inp->args[0].location);			
			bs_thread((void *)inp->args[0].location);
			
			//indicate that you have consumed the message
			*(uint32_t*)inp = ~(0xF00F0FF0);

			//Start replying
			struct offload_struct ofld_vranlc ;

			ofld_vranlc.new_request = 0xF00F0FF0;
			void * write_pointer = (void*)((char*)rw_buf.write_area + 0x1000);
			


        		ofld_vranlc.type = COMPUTE_VRANLC;
        		ofld_vranlc.args[0].size = 1;
        		ofld_vranlc.args[0].type = INT;
        		ofld_vranlc.args[1].size = 1;
			ofld_vranlc.args[1].type = DOUBLE;
        		ofld_vranlc.args[2].size = 1;
        		ofld_vranlc.args[2].type = DOUBLE;
        		ofld_vranlc.args[3].size = 1;
        		ofld_vranlc.args[3].type = DOUBLE;

        		memcpy((void*)rw_buf.write_area , (void*)&ofld_vranlc , sizeof(struct offload_struct) );				
		   }
		  else if (inp->type == 0xDE)
		  {
			printf("x86 wants to go away , I am leaving too\n");
			break;
		  }
	     }
	}
	tid = 1;
	//bs_thread((void*)&tid);
	printf("ARM_kernel_exiting\n");
     	*((uint32_t*)rw_buf.read_area) = 0x00000000 ;
     	*((uint32_t*)rw_buf.write_area) = 0x00000000 ;
	while(1);
}
```

## src/blackscholes.c
```c
// Copyright (c) 2007 Intel Corp.

// Black-Scholes
// Analytical method for calculating European Options
//
// 
// Reference Source: Options, Futures, and Other Derivatives, 3rd Edition, Prentice 
// Hall, John C. Hull,
#include "inc.h"
#include <stdio.h>
#include <stdlib.h>
#include <math.h>
#include <string.h>
//#include "migrate.h"
#include <pthread.h>
#include <sys/util.h>
#include <fcntl.h>
#include <sys/printk.h>

#ifdef ENABLE_PARSEC_HOOKS
#include <hooks.h>
#endif

//#define STACKSIZ ((8192 *2) + CONFIG_TEST_EXTRA_STACKSIZE)

//K_THREAD_STACK_ARRAY_DEFINE(blasch_stacks, 2 , STACKSIZ);

#define ENABLE_THREADS 1
// Multi-threaded pthreads header
#ifdef ENABLE_THREADS
// Add the following line so that icc 9.0 is compatible with pthread lib.
#define __thread __threadp

#ifdef _XOPEN_SOURCE
#undef _XOPEN_SOURCE
#define _XOPEN_SOURCE 700
#endif
#ifndef _GNU_SOURCE
#define _GNU_SOURCE
#endif
#ifndef __USE_XOPEN2K
#define __USE_XOPEN2K
#endif
#ifndef __USE_UNIX98
#define __USE_UNIX98
#endif
#include <pthread.h>
#include <time.h>




#define MAX_THREADS 128

pthread_t _M4_threadsTable[MAX_THREADS];
int _M4_threadsTableAllocated[MAX_THREADS];
pthread_mutexattr_t _M4_normalMutexAttr;
int _M4_numThreads = MAX_THREADS;

#undef __thread
#endif

// Multi-threaded OpenMP header
#ifdef ENABLE_OPENMP
#include <omp.h>
#endif

#include <sys/types.h>

#ifdef ENABLE_TBB
#include "tbb/blocked_range.h"
#include "tbb/parallel_for.h"
#include "tbb/task_scheduler_init.h"
#include "tbb/tick_count.h"

using namespace std;
using namespace tbb;
#endif //ENABLE_TBB

// Multi-threaded header for Windows
#ifdef WIN32
#pragma warning(disable : 4305)
#pragma warning(disable : 4244)
#include <windows.h>
#endif

//Precision to use for calculations
#define fptype float

#define NUM_RUNS 500


extern OptionData datainit[10];
OptionData data_compute[1000];
//= 0x70000000;
OptionData *data;
fptype *prices;
int numOptions;

int    * otype;
fptype * sptprice;
fptype * strike;
fptype * rate;
fptype * volatility;
fptype * otime;
int numError = 0;
int nThreads;

volatile int waitLock;

////////////////////////////////////////////////////////////////////////////////
////////////////////////////////////////////////////////////////////////////////
///////////////////////////////////////////////////////////////////////////////
////////////////////////////////////////////////////////////////////////////////
// Cumulative Normal Distribution Function
// See Hull, Section 11.8, P.243-244
#define inv_sqrt_2xPI 0.39894228040143270286

fptype CNDF ( fptype InputX ) 
{
    int sign;

    fptype OutputX;
    fptype xInput;
    fptype xNPrimeofX;
    fptype expValues;
    fptype xK2;
    fptype xK2_2, xK2_3;
    fptype xK2_4, xK2_5;
    fptype xLocal, xLocal_1;
    fptype xLocal_2, xLocal_3;

    // Check for negative value of InputX
    if (InputX < 0.0) {
        InputX = -InputX;
        sign = 1;
    } else 
        sign = 0;

    xInput = InputX;
 
    // Compute NPrimeX term common to both four & six decimal accuracy calcs
    expValues = exp(-0.5f * InputX * InputX);
    xNPrimeofX = expValues;
    xNPrimeofX = xNPrimeofX * inv_sqrt_2xPI;

    xK2 = 0.2316419 * xInput;
    xK2 = 1.0 + xK2;
    xK2 = 1.0 / xK2;
    xK2_2 = xK2 * xK2;
    xK2_3 = xK2_2 * xK2;
    xK2_4 = xK2_3 * xK2;
    xK2_5 = xK2_4 * xK2;
    
    xLocal_1 = xK2 * 0.319381530;
    xLocal_2 = xK2_2 * (-0.356563782);
    xLocal_3 = xK2_3 * 1.781477937;
    xLocal_2 = xLocal_2 + xLocal_3;
    xLocal_3 = xK2_4 * (-1.821255978);
    xLocal_2 = xLocal_2 + xLocal_3;
    xLocal_3 = xK2_5 * 1.330274429;
    xLocal_2 = xLocal_2 + xLocal_3;

    xLocal_1 = xLocal_2 + xLocal_1;
    xLocal   = xLocal_1 * xNPrimeofX;
    xLocal   = 1.0 - xLocal;

    OutputX  = xLocal;
    
    if (sign) {
        OutputX = 1.0 - OutputX;
    }
    
    return OutputX;
} 

//////////////////////////////////////////////////////////////////////////////////////
//////////////////////////////////////////////////////////////////////////////////////
//////////////////////////////////////////////////////////////////////////////////////
//////////////////////////////////////////////////////////////////////////////////////
fptype BlkSchlsEqEuroNoDiv( fptype sptprice,
                            fptype strike, fptype rate, fptype volatility,
                            fptype time, int otype, float timet )
{
    fptype OptionPrice;

    // local private working variables for the calculation
    fptype xStockPrice;
    fptype xStrikePrice;
    fptype xRiskFreeRate;
    fptype xVolatility;
    fptype xTime;
    fptype xSqrtTime;

    fptype logValues;
    fptype xLogTerm;
    fptype xD1; 
    fptype xD2;
    fptype xPowerTerm;
    fptype xDen;
    fptype d1;
    fptype d2;
    fptype FutureValueX;
    fptype NofXd1;
    fptype NofXd2;
    fptype NegNofXd1;
    fptype NegNofXd2;    
    
    xStockPrice = sptprice;
    xStrikePrice = strike;
    xRiskFreeRate = rate;
    xVolatility = volatility;

    xTime = time;
    xSqrtTime = sqrt(xTime);

    logValues = log( sptprice / strike );
        
    xLogTerm = logValues;
        
    
    xPowerTerm = xVolatility * xVolatility;
    xPowerTerm = xPowerTerm * 0.5;
        
    xD1 = xRiskFreeRate + xPowerTerm;
    xD1 = xD1 * xTime;
    xD1 = xD1 + xLogTerm;

    xDen = xVolatility * xSqrtTime;
    xD1 = xD1 / xDen;
    xD2 = xD1 -  xDen;

    d1 = xD1;
    d2 = xD2;
    
    NofXd1 = CNDF( d1 );
    NofXd2 = CNDF( d2 );

    FutureValueX = strike * ( exp( -(rate)*(time) ) );        
    if (otype == 0) {            
        OptionPrice = (sptprice * NofXd1) - (FutureValueX * NofXd2);
    } else { 
        NegNofXd1 = (1.0 - NofXd1);
        NegNofXd2 = (1.0 - NofXd2);
        OptionPrice = (FutureValueX * NegNofXd2) - (sptprice * NegNofXd1);
    }
    
    return OptionPrice;
}

#ifdef ENABLE_TBB
struct mainWork {
  mainWork() {}
  mainWork(mainWork &w, tbb::split) {}

  void operator()(const tbb::blocked_range<int> &range) const {
    fptype price;
    int begin = range.begin();
    int end = range.end();

    for (int i=begin; i!=end; i++) {
      /* Calling main function to calculate option value based on 
       * Black & Scholes's equation.
       */

      price = BlkSchlsEqEuroNoDiv( sptprice[i], strike[i],
                                   rate[i], volatility[i], otime[i], 
                                   otype[i], 0);
      prices[i] = price;

#ifdef ERR_CHK 
      fptype priceDelta = data[i].DGrefval - price;
      if( fabs(priceDelta) >= 1e-5 ){
        fprintf(stderr,"Error on %d. Computed=%.5f, Ref=%.5f, Delta=%.5f\n",
               i, price, data[i].DGrefval, priceDelta);
        numError ++;
      }
#endif
    }
  }
};

#endif // ENABLE_TBB

//////////////////////////////////////////////////////////////////////////////////////
//////////////////////////////////////////////////////////////////////////////////////
//////////////////////////////////////////////////////////////////////////////////////
//////////////////////////////////////////////////////////////////////////////////////

volatile int __bsHold;

#ifdef ENABLE_TBB
int bs_thread(void *tid_ptr) {
    int j;
    tbb::affinity_partitioner a;

    mainWork doall;
    for (j=0; j<NUM_RUNS; j++) {
      tbb::parallel_for(tbb::blocked_range<int>(0, numOptions), doall, a);
    }

    return 0;
}
#else // !ENABLE_TBB

#ifdef WIN32
DWORD WINAPI bs_thread(LPVOID tid_ptr){
#else
int bs_thread(void *tid_ptr) {
#endif
    int i, j;
    fptype price;
    fptype priceDelta;
    int tid = *(int *)tid_ptr;
    int start = tid * (numOptions / nThreads);
    int end = start + (numOptions / nThreads);
    
	printf("Thread %d/%d %d %d\n", tid, nThreads, start, end);
//	if (tid % 2) migrate(1, NULL, NULL);

//	__bsHold = 1;
//	while (__bsHold)
//	  ;

    for (j=0; j<NUM_RUNS; j++) {
#ifdef ENABLE_OPENMP
#pragma omp parallel for private(i, price, priceDelta)
        for (i=0; i<numOptions; i++) {
#else  //ENABLE_OPENMP
        for (i=start; i<end; i++) {
#endif //ENABLE_OPENMP
            /* Calling main function to calculate option value based on 
             * Black & Scholes's equation.
             */
            price = BlkSchlsEqEuroNoDiv( sptprice[i], strike[i],
                                         rate[i], volatility[i], otime[i], 
                                         otype[i], 0);
           prices[i] = price;
	    
#ifdef ERR_CHK
            priceDelta = data[i].DGrefval - price;
            if( fabs(priceDelta) >= 1e-4 ){
                printf("Error on %d. Computed=%.5f, Ref=%.5f, Delta=%.5f\n",
                       i, price, data[i].DGrefval, priceDelta);
                numError ++;
            }
#endif
        }
    }
	
    printf("%d\n", numOptions);
    for(i=0; i<numOptions; i++) {
      printf("%.18f\n", prices[i]);
    }
//	if (tid % 2) migrate(0, NULL, NULL);
	//pthread_exit(tid_ptr);
    return 0;
}
#endif //ENABLE_TBB

int blackscholes_main ()
{
    FILE *file;
    int i;
    int loopnum;
    fptype * buffer;
    int * buffer2;
    int rv;
    init_data_init();
#ifdef PARSEC_VERSION
#define __PARSEC_STRING(x) #x
#define __PARSEC_XSTRING(x) __PARSEC_STRING(x)
        printf("PARSEC Benchmark Suite Version "__PARSEC_XSTRING(PARSEC_VERSION)"\n");
#else
        printf("PARSEC Benchmark Suite\n");
#endif //PARSEC_VERSION
#ifdef ENABLE_PARSEC_HOOKS
   __parsec_bench_begin(__parsec_blackscholes);
#endif
		
	for(int i = 0 ; i < 250 ; i++)
	{
		memcpy((void*)&data_compute[i*4], (void*)datainit , 4*sizeof(OptionData));
	}
	for(int i = 0 ; i<4; i++)
	{
	printf("i copied %f %f %f %f %f %f %c %f %f\n", data_compute[i].s, data_compute[i].strike, data_compute[i].r, data_compute[i].divq, data_compute[i].v, data_compute[i].t, data_compute[i].OptionType, data_compute[i].divs, data_compute[i].DGrefval);
//	printf("initialized %f %f %f %f %f %f %c %f %f\n", datainit[loopnum].s, datainit[loopnum].strike, datainit[loopnum].r, datainit[loopnum].divq, datainit[loopnum].v, datainit[loopnum].t, datainit[loopnum].OptionType, datainit[loopnum].divs, datainit[loopnum].DGrefval);
        	
	}	
/*   if (argc != 4)
        {
                printf("Usage:\n\t%s <nthreads> <inputFile> <outputFile>\n", argv[0]);
                exit(1);
        }
*/
    nThreads = 4;
//    char *inputFile = argv[2];
//    char *outputFile = argv[3];

    //Read input data from file
    numOptions = 20;
    if(nThreads > numOptions) {
      printf("WARNING: Not enough work, reducing number of threads to match number of options.\n");
      nThreads = numOptions;
    }

#if !defined(ENABLE_THREADS) && !defined(ENABLE_OPENMP) && !defined(ENABLE_TBB)
    if(nThreads != 1) {
        printf("Error: <nthreads> must be 1 (serial version)\n");
        exit(1);
    }
#endif

    // alloc spaces for the option data
	data = data_compute;
    prices = (fptype*)malloc(numOptions*sizeof(fptype));
//    data = (OptionData*)malloc(numOptions*sizeof(OptionData));


#ifdef ENABLE_THREADS
    
    pthread_mutexattr_init( &_M4_normalMutexAttr);
//    pthread_mutexattr_settype( &_M4_normalMutexAttr, PTHREAD_MUTEX_NORMAL);
    _M4_numThreads = nThreads;
    {
        int _M4_i;
        for ( _M4_i = 0; _M4_i < MAX_THREADS; _M4_i++) {
            _M4_threadsTableAllocated[_M4_i] = 0;
        }
    }
;
#endif
    printf("Num of Options: %d\n", numOptions);
    printf("Num of Runs: %d\n", NUM_RUNS);

#define PAD 256
#define LINESIZE 64

    buffer = (fptype *) malloc(5 * numOptions * sizeof(fptype) + PAD);
    sptprice = (fptype *) (((unsigned long long)buffer + PAD) & ~(LINESIZE - 1));
    strike = sptprice + numOptions;
    rate = strike + numOptions;
    volatility = rate + numOptions;
    otime = volatility + numOptions;

    buffer2 = (int *) malloc(numOptions * sizeof(fptype) + PAD);
    otype = (int *) (((unsigned long long)buffer2 + PAD) & ~(LINESIZE - 1));

    for (i=0; i<numOptions; i++) {
        otype[i]      = (data[i].OptionType == 'P') ? 1 : 0;
	sptprice[i]   = data[i].s;
        strike[i]     = data[i].strike;
        rate[i]       = data[i].r;
        volatility[i] = data[i].v;    
        otime[i]      = data[i].t;
    }

    printf("Size of data: %d\n", numOptions * (sizeof(OptionData) + sizeof(int)));

#ifdef ENABLE_PARSEC_HOOKS
    __parsec_roi_begin();
#endif

#ifdef ENABLE_THREADS
#ifdef WIN32
    HANDLE *threads;
    int *nums;
    threads = (HANDLE *) malloc (nThreads * sizeof(HANDLE));
    nums = (int *) malloc (nThreads * sizeof(int));

    for(i=0; i<nThreads; i++) {
        nums[i] = i;
        threads[i] = CreateThread(0, 0, bs_thread, &nums[i], 0, 0);
    }
    WaitForMultipleObjects(nThreads, threads, TRUE, INFINITE);
#else
    int *tids;
    tids = (int *) malloc (nThreads * sizeof(int));
    pthread_attr_t attr[2];
    for(i=0; i<nThreads; i++) {
        tids[i]=i;
//	pthread_attr_init(&attr[i]);
//	pthread_attr_setstack(&attr[i], &blasch_stacks[i][0], STACKSIZ);
        
    {
        int _M4_i;
        for ( _M4_i = 0; _M4_i < MAX_THREADS; _M4_i++) {
            if ( _M4_threadsTableAllocated[_M4_i] == 0)    break;
        }
//        pthread_create(&_M4_threadsTable[_M4_i],&attr[i],(void *(*)(void *))bs_thread,(void *)&tids[i]);
        _M4_threadsTableAllocated[_M4_i] = 1;
    }
;
    }
   	usleep(USEC_PER_MSEC * 100U); 
    {
        int _M4_i;
        void *_M4_ret;
        for ( _M4_i = 0; _M4_i < MAX_THREADS;_M4_i++) {
            if ( _M4_threadsTableAllocated[_M4_i] == 0)    break;
         //   pthread_join( _M4_threadsTable[_M4_i], &_M4_ret);
        }
    }
;
#endif //WIN32
#else //ENABLE_THREADS
#ifdef ENABLE_OPENMP
    {
        int tid=0;
        omp_set_num_threads(nThreads);
        bs_thread(&tid);
    }
#else //ENABLE_OPENMP
#ifdef ENABLE_TBB
    tbb::task_scheduler_init init(nThreads);

    int tid=0;
    bs_thread(&tid);
#else //ENABLE_TBB
    //serial version
    int tid=0;
    bs_thread(&tid);
#endif //ENABLE_TBB
#endif //ENABLE_OPENMP
#endif //ENABLE_THREADS

#ifdef ENABLE_PARSEC_HOOKS
    __parsec_roi_end();
#endif

    //Write prices to output file
//    printf("%d\n", numOptions);
    for(i=0; i<numOptions; i++) {
  //    printf("%.18f\n", prices[i]);
    }

#ifdef ERR_CHK
    printf("Num Errors: %d\n", numError);
#endif

#ifdef ENABLE_PARSEC_HOOKS
    __parsec_bench_end();
#endif

    return 0;
}
```

## src/inc.h
```c
#ifndef INC_H
#define INC_H

#define fptype float

typedef struct OptionData_ {
        fptype s;          // spot price
        fptype strike;     // strike price
        fptype r;          // risk-free interest rate
        fptype divq;       // dividend rate
        fptype v;          // volatility
        fptype t;          // time to maturity or option expiration in years 
                           //     (1yr = 1.0, 6mos = 0.5, 3mos = 0.25, ..., etc)  
        volatile char OptionType;   // Option type.  "P"=PUT, "C"=CALL
        fptype divs;       // dividend vals (not used in this test)
        fptype DGrefval;   // DerivaGem Reference Value
} OptionData;
#endif
```

## src/inputs.c
```c
#include "inc.h"
OptionData datainit[4];


void init_data_init(){
datainit[0].s            = 42.0;
datainit[0].strike       = 40.00;
datainit[0].r            = 0.1000;
datainit[0].divq         = 0.00;
datainit[0].v            = 0.20;
datainit[0].t            = 0.50;
datainit[0].OptionType   = 'C';
datainit[0].divs         = 0.00;
datainit[0].DGrefval     = 4.759423036851750055;

datainit[1].s		= 42.00;
datainit[1].strike	= 40.00;
datainit[1].r		= 0.1000;
datainit[1].divq	= 0.00 ;
datainit[1].v		= 0.20;
datainit[1].t		= 0.50;
datainit[1].OptionType	= 'P';
datainit[1].divs	= 0.00; 
datainit[1].DGrefval	= 0.808600016880314021;


datainit[2].s		= 100.00 ;
datainit[2].strike	= 100.00;
datainit[2].r		= 0.0500;
datainit[2].divq	= 0.00;
datainit[2].v		= 0.15;
datainit[2].t		= 1.00;
datainit[2].OptionType	= 'P';
datainit[2].divs	= 0.00;
datainit[2].DGrefval	= 3.714602051381290071;


datainit[3].s		= 100.00;
datainit[3].strike	= 100.00;
datainit[3].r		= 0.0500;
datainit[3].divq	= 0.00;
datainit[3].v		= 0.15;
datainit[3].t		= 1.00;
datainit[3].OptionType	= 'C';
datainit[3].divs	= 0.00;
datainit[3].DGrefval	= 8.591659601309890704;
}
#if 0
datainit[4].s            = 
datainit[4].strike       =
datainit[4].r            =
datainit[4].divq         =
datainit[4].v            =
datainit[4].t            =
datainit[4].OptionType   =
datainit[4].divs         =
datainit[4].DGrefval     =


datainit[5].s            = 
datainit[5].strike       =
datainit[5].r            =
datainit[5].divq         =
datainit[5].v            =
datainit[5].t            =
datainit[5].OptionType   =
datainit[5].divs         =
datainit[5].DGrefval     =


datainit[6].s            = 
datainit[6].strike       =
datainit[6].r            =
datainit[6].divq         =
datainit[6].v            =
datainit[6].t            =
datainit[6].OptionType   =
datainit[6].divs         =
datainit[6].DGrefval     =


datainit[7].s            = 
datainit[7].strike       =
datainit[7].r            =
datainit[7].divq         =
datainit[7].v            =
datainit[7].t            =
datainit[7].OptionType   =
datainit[7].divs         =
datainit[7].DGrefval     =


datainit[8].s            = 
datainit[8].strike       =
datainit[8].r            =
datainit[8].divq         =
datainit[8].v            =
datainit[8].t            =
datainit[8].OptionType   =
datainit[8].divs         =
datainit[8].DGrefval     =


datainit[9].s            = 
datainit[9].strike       =
datainit[9].r            =
datainit[9].divq         =
datainit[9].v            =
datainit[9].t            =
datainit[9].OptionType   =
datainit[9].divs         =
datainit[9].DGrefval     =
#endif
```
