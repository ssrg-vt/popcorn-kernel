## prj.conf
```kconfig
CONFIG_PCIE=y
CONFIG_VIRTUALIZATION=y
CONFIG_IVSHMEM=y
```

## aarch64_kernel_config.conf
```kconfig
# CONFIG_GPIO is not set
# CONFIG_SPI is not set
# CONFIG_I2C is not set
# CONFIG_KSCAN is not set
# CONFIG_WIFI is not set
# CONFIG_MODEM is not set
CONFIG_UART_INTERRUPT_DRIVEN=y
CONFIG_BUILD_OUTPUT_BIN=y
CONFIG_BOARD="qemu_cortex_a53"
CONFIG_SYS_CLOCK_HW_CYCLES_PER_SEC=62500000
CONFIG_NUM_IRQS=220
CONFIG_SOC="qemu_cortex_a53"
CONFIG_FLASH_SIZE=65536
CONFIG_FLASH_BASE_ADDRESS=0x0

#
# Modules
#

#
# Available modules.
#

#
# CANopenNode (/home/ashwin/zephyrproject/modules/lib/canopennode)
#
CONFIG_ZEPHYR_CANOPENNODE_MODULE=y
# end of CANopenNode (/home/ashwin/zephyrproject/modules/lib/canopennode)

#
# hal_nordic (/home/ashwin/zephyrproject/modules/hal/nordic)
#
CONFIG_ZEPHYR_HAL_NORDIC_MODULE=y
# end of hal_nordic (/home/ashwin/zephyrproject/modules/hal/nordic)

#
# hal_nxp (/home/ashwin/zephyrproject/modules/hal/nxp)
#
CONFIG_ZEPHYR_HAL_NXP_MODULE=y
# end of hal_nxp (/home/ashwin/zephyrproject/modules/hal/nxp)

#
# loramac-node (/home/ashwin/zephyrproject/modules/lib/loramac-node)
#
CONFIG_ZEPHYR_LORAMAC_NODE_MODULE=y
# CONFIG_HAS_SEMTECH_RADIO_DRIVERS is not set
# end of loramac-node (/home/ashwin/zephyrproject/modules/lib/loramac-node)

#
# lz4 (/home/ashwin/zephyrproject/modules/lib/lz4)
#
CONFIG_ZEPHYR_LZ4_MODULE=y
# CONFIG_LZ4 is not set
# end of lz4 (/home/ashwin/zephyrproject/modules/lib/lz4)

#
# mbedtls (/home/ashwin/zephyrproject/modules/crypto/mbedtls)
#
CONFIG_ZEPHYR_MBEDTLS_MODULE=y
# CONFIG_MBEDTLS is not set
# end of mbedtls (/home/ashwin/zephyrproject/modules/crypto/mbedtls)

#
# nanopb (/home/ashwin/zephyrproject/modules/lib/nanopb)
#
CONFIG_ZEPHYR_NANOPB_MODULE=y
# CONFIG_NANOPB is not set
# end of nanopb (/home/ashwin/zephyrproject/modules/lib/nanopb)

#
# sof (/home/ashwin/zephyrproject/modules/audio/sof)
#
# CONFIG_DEBUG is not set
CONFIG_ZEPHYR_SOF_MODULE=y
# end of sof (/home/ashwin/zephyrproject/modules/audio/sof)

#
# tflite-micro (/home/ashwin/zephyrproject/modules/lib/tflite-micro)
#
# CONFIG_TENSORFLOW_LITE_MICRO is not set
CONFIG_ZEPHYR_TFLITE_MICRO_MODULE=y
# end of tflite-micro (/home/ashwin/zephyrproject/modules/lib/tflite-micro)

#
# TraceRecorder (/home/ashwin/zephyrproject/modules/debug/TraceRecorder)
#
CONFIG_ZEPHYR_TRACERECORDER_MODULE=y
# end of TraceRecorder (/home/ashwin/zephyrproject/modules/debug/TraceRecorder)

#
# trusted-firmware-m (/home/ashwin/zephyrproject/modules/tee/tfm)
#
CONFIG_ZEPHYR_TRUSTED_FIRMWARE_M_MODULE=y
CONFIG_ROM_START_OFFSET=0
# end of trusted-firmware-m (/home/ashwin/zephyrproject/modules/tee/tfm)

#
# Optional modules. Make sure they're installed, via the project manifest.
#
# CONFIG_CIVETWEB is not set
# CONFIG_CMSIS_DSP is not set
# CONFIG_LIBMETAL is not set
# CONFIG_HAS_MEC_HAL is not set
# CONFIG_OPENAMP is not set
# CONFIG_SOF is not set
# CONFIG_MIPI_SYST_LIB is not set
# CONFIG_HAS_TELINK_DRIVERS is not set
# CONFIG_TINYCBOR is not set
# CONFIG_TINYCRYPT is not set
# CONFIG_MCUBOOT_BOOTUTIL_LIB is not set

#
# Unavailable modules, please install those via the project manifest.
#
# end of Modules

CONFIG_QEMU_TARGET=y
CONFIG_BOARD_QEMU_CORTEX_A53=y

#
# Board Options
#
# CONFIG_QEMU_ICOUNT is not set
# end of Board Options

# CONFIG_SOC_SERIES_FVP_AEMV8A is not set
# CONFIG_SOC_SERIES_FVP_AEMV8R is not set
# CONFIG_SOC_SERIES_VIPER is not set
# CONFIG_SOC_SERIES_LS1046A is not set
CONFIG_SOC_QEMU_CORTEX_A53=y
# CONFIG_SOC_XENVM is not set

#
# Hardware Configuration
#
# end of Hardware Configuration

#
# ARM64 Options
#
CONFIG_ARCH="arm64"
CONFIG_CPU_CORTEX=y
CONFIG_CPU_CORTEX_A=y
CONFIG_CPU_CORTEX_A53=y
CONFIG_HAS_ARM_SMCCC=y
CONFIG_MAIN_STACK_SIZE=4096
CONFIG_IDLE_STACK_SIZE=4096
CONFIG_ISR_STACK_SIZE=4096
CONFIG_TEST_EXTRA_STACKSIZE=2048
CONFIG_SYSTEM_WORKQUEUE_STACK_SIZE=4096
CONFIG_CMSIS_THREAD_MAX_STACK_SIZE=4096
CONFIG_CMSIS_V2_THREAD_MAX_STACK_SIZE=4096
CONFIG_CMSIS_V2_THREAD_DYNAMIC_STACK_SIZE=4096
CONFIG_IPM_CONSOLE_STACK_SIZE=2048
CONFIG_AARCH64_IMAGE_HEADER=y
CONFIG_PRIVILEGED_STACK_SIZE=4096
CONFIG_KOBJECT_TEXT_AREA=256
CONFIG_ARMV8_A_NS=y
CONFIG_ARMV8_A=y
CONFIG_GEN_ISR_TABLES=y
# CONFIG_GEN_IRQ_VECTOR_TABLE is not set
CONFIG_ARM_MMU=y
# CONFIG_XIP is not set
CONFIG_MMU_PAGE_SIZE=0x1000
CONFIG_ARM64_VA_BITS_32=y
# CONFIG_ARM64_VA_BITS_36 is not set
# CONFIG_ARM64_VA_BITS_40 is not set
# CONFIG_ARM64_VA_BITS_42 is not set
# CONFIG_ARM64_VA_BITS_48 is not set
CONFIG_ARM64_VA_BITS=32
CONFIG_ARM64_PA_BITS_32=y
# CONFIG_ARM64_PA_BITS_36 is not set
# CONFIG_ARM64_PA_BITS_40 is not set
# CONFIG_ARM64_PA_BITS_42 is not set
# CONFIG_ARM64_PA_BITS_48 is not set
CONFIG_ARM64_PA_BITS=32
CONFIG_MAX_XLAT_TABLES=8
# end of ARM64 Options

CONFIG_ARM64=y
CONFIG_ARCH_IS_SET=y

#
# General Architecture Options
#
CONFIG_64BIT=y
CONFIG_SRAM_SIZE=131072
CONFIG_SRAM_BASE_ADDRESS=0x40000000
# CONFIG_USERSPACE is not set
CONFIG_KOBJECT_DATA_AREA_RESERVE_EXTRA_PERCENT=100
CONFIG_KOBJECT_RODATA_AREA_EXTRA_BYTES=16
# CONFIG_STACK_GROWS_UP is not set

#
# Interrupt Configuration
#
# CONFIG_DYNAMIC_INTERRUPTS is not set
CONFIG_GEN_SW_ISR_TABLE=y
CONFIG_ARCH_SW_ISR_TABLE_ALIGN=0
CONFIG_GEN_IRQ_START_VECTOR=0
# end of Interrupt Configuration
# end of General Architecture Options

CONFIG_ARCH_HAS_USERSPACE=y
CONFIG_ARCH_HAS_THREAD_LOCAL_STORAGE=y
CONFIG_CPU_HAS_FPU=y
CONFIG_CPU_HAS_MMU=y
CONFIG_MMU=y
CONFIG_KERNEL_VM_BASE=0x40000000
CONFIG_KERNEL_VM_OFFSET=0
CONFIG_KERNEL_VM_SIZE=0x800000
CONFIG_SRAM_REGION_PERMISSIONS=y

#
# Floating Point Options
#
CONFIG_FPU=y
CONFIG_FPU_SHARING=y
# end of Floating Point Options

#
# Cache Options
#
CONFIG_CACHE_MANAGEMENT=y
# CONFIG_DCACHE_LINE_SIZE_DETECT is not set
CONFIG_DCACHE_LINE_SIZE=0
# CONFIG_ICACHE_LINE_SIZE_DETECT is not set
CONFIG_ICACHE_LINE_SIZE=0
CONFIG_HAS_ARCH_CACHE=y
# CONFIG_HAS_EXTERNAL_CACHE is not set
# end of Cache Options

CONFIG_TOOLCHAIN_HAS_BUILTIN_FFS=y

#
# General Kernel Options
#
CONFIG_MULTITHREADING=y
CONFIG_NUM_COOP_PRIORITIES=16
CONFIG_NUM_PREEMPT_PRIORITIES=15
CONFIG_MAIN_THREAD_PRIORITY=0
CONFIG_COOP_ENABLED=y
CONFIG_PREEMPT_ENABLED=y
CONFIG_PRIORITY_CEILING=-127
CONFIG_NUM_METAIRQ_PRIORITIES=0
# CONFIG_SCHED_DEADLINE is not set
# CONFIG_SCHED_CPU_MASK is not set
# CONFIG_THREAD_STACK_INFO is not set
# CONFIG_THREAD_CUSTOM_DATA is not set
CONFIG_ERRNO=y
CONFIG_SCHED_DUMB=y
# CONFIG_SCHED_SCALABLE is not set
# CONFIG_SCHED_MULTIQ is not set
# CONFIG_WAITQ_SCALABLE is not set
CONFIG_WAITQ_DUMB=y

#
# Kernel Debugging and Metrics
#
# CONFIG_INIT_STACKS is not set
CONFIG_BOOT_BANNER=y
CONFIG_BOOT_DELAY=0
# CONFIG_THREAD_MONITOR is not set
# CONFIG_THREAD_NAME is not set
# CONFIG_THREAD_RUNTIME_STATS is not set
# end of Kernel Debugging and Metrics

#
# Work Queue Options
#
CONFIG_SYSTEM_WORKQUEUE_PRIORITY=-1
# CONFIG_SYSTEM_WORKQUEUE_NO_YIELD is not set
# end of Work Queue Options

#
# Atomic Operations
#
CONFIG_ATOMIC_OPERATIONS_BUILTIN=y
# end of Atomic Operations

#
# Timer API Options
#
CONFIG_TIMESLICING=y
CONFIG_TIMESLICE_SIZE=0
CONFIG_TIMESLICE_PRIORITY=0
# CONFIG_POLL is not set
# end of Timer API Options

#
# Other Kernel Object Options
#
# CONFIG_MEM_SLAB_TRACE_MAX_UTILIZATION is not set
CONFIG_NUM_MBOX_ASYNC_MSGS=10
CONFIG_NUM_PIPE_ASYNC_MSGS=10
CONFIG_KERNEL_MEM_POOL=y
CONFIG_HEAP_MEM_POOL_SIZE=0
# end of Other Kernel Object Options

CONFIG_ARCH_HAS_CUSTOM_BUSY_WAIT=y
CONFIG_SYS_CLOCK_TICKS_PER_SEC=100
CONFIG_SYS_CLOCK_EXISTS=y
CONFIG_TIMEOUT_64BIT=y

#
# Initialization Priorities
#
CONFIG_KERNEL_INIT_PRIORITY_OBJECTS=30
CONFIG_KERNEL_INIT_PRIORITY_DEFAULT=40
CONFIG_KERNEL_INIT_PRIORITY_DEVICE=50
CONFIG_APPLICATION_INIT_PRIORITY=90
# end of Initialization Priorities

#
# Security Options
#
# end of Security Options

#
# SMP Options
#
CONFIG_USE_SWITCH=y
CONFIG_USE_SWITCH_SUPPORTED=y
# CONFIG_SMP is not set
CONFIG_MP_NUM_CPUS=1
# end of SMP Options

CONFIG_TICKLESS_KERNEL=y
# end of General Kernel Options

CONFIG_HAS_DTS=y

#
# Device Drivers
#
# CONFIG_IEEE802154 is not set
# CONFIG_LORA is not set
CONFIG_CONSOLE=y
CONFIG_CONSOLE_INPUT_MAX_LINE_LEN=128
CONFIG_CONSOLE_HAS_DRIVER=y
# CONFIG_CONSOLE_HANDLER is not set
CONFIG_UART_CONSOLE=y
CONFIG_UART_CONSOLE_INIT_PRIORITY=60
# CONFIG_UART_CONSOLE_DEBUG_SERVER_HOOKS is not set
# CONFIG_UART_CONSOLE_MCUMGR is not set
# CONFIG_USB_UART_CONSOLE is not set
# CONFIG_RAM_CONSOLE is not set
# CONFIG_IPM_CONSOLE_SENDER is not set
# CONFIG_IPM_CONSOLE_RECEIVER is not set
# CONFIG_UART_PIPE is not set
# CONFIG_UART_MCUMGR is not set
# CONFIG_SEMIHOST_CONSOLE is not set
# CONFIG_GSM_MUX is not set
# CONFIG_EC_HOST_CMD_PERIPH is not set
# CONFIG_MDIO is not set
# CONFIG_NET_LOOPBACK is not set
CONFIG_SERIAL=y

#
# Capabilities
#
CONFIG_SERIAL_HAS_DRIVER=y
CONFIG_SERIAL_SUPPORT_INTERRUPT=y
CONFIG_UART_USE_RUNTIME_CONFIGURE=y
# CONFIG_UART_LINE_CTRL is not set
# CONFIG_UART_DRV_CMD is not set

#
# Serial Drivers
#
# CONFIG_UART_NS16550 is not set
# CONFIG_UART_ALTERA_JTAG is not set
CONFIG_UART_PL011=y
CONFIG_UART_PL011_PORT0=y
# CONFIG_UART_PL011_PORT1 is not set
# CONFIG_UART_PL011_SBSA is not set
# CONFIG_UART_XLNX_UARTLITE is not set

#
# Interrupt Controllers
#
# CONFIG_SWERV_PIC is not set
# CONFIG_MULTI_LEVEL_INTERRUPTS is not set
CONFIG_GIC=y
CONFIG_GIC_V3=y
CONFIG_GIC_VER=3
# CONFIG_INTC_ESP32 is not set
# end of Interrupt Controllers

#
# Timer Drivers
#
# CONFIG_HPET_TIMER is not set
CONFIG_ARM_ARCH_TIMER=y
# CONFIG_SYSTEM_CLOCK_DISABLE is not set
# CONFIG_TIMER_READS_ITS_FREQUENCY_AT_RUNTIME is not set
# CONFIG_SYSTEM_CLOCK_SLOPPY_IDLE is not set
CONFIG_SYSTEM_CLOCK_INIT_PRIORITY=0
CONFIG_TICKLESS_CAPABLE=y
# end of Timer Drivers

# CONFIG_ENTROPY_GENERATOR is not set
# CONFIG_PCIE is not set
# CONFIG_PCIE_ENDPOINT is not set
# CONFIG_SHARED_IRQ is not set
# CONFIG_I2S is not set
# CONFIG_PWM is not set
# CONFIG_PINMUX is not set
# CONFIG_ADC is not set
# CONFIG_DAC is not set
# CONFIG_WATCHDOG is not set
# CONFIG_CLOCK_CONTROL is not set
# CONFIG_PTP_CLOCK is not set
# CONFIG_IPM is not set
# CONFIG_FLASH is not set
# CONFIG_SENSOR is not set
# CONFIG_COUNTER is not set
# CONFIG_DMA is not set
# CONFIG_USB_DEVICE_DRIVER is not set
# CONFIG_CRYPTO is not set
# CONFIG_DISPLAY is not set
# CONFIG_LED_STRIP is not set
# CONFIG_LED is not set
# CONFIG_CAN is not set
# CONFIG_AUDIO is not set
# CONFIG_NEURAL_NET_ACCEL is not set
# CONFIG_HWINFO is not set
# CONFIG_ESPI is not set
# CONFIG_PS2 is not set
# CONFIG_VIDEO is not set
# CONFIG_EEPROM is not set
# CONFIG_PECI is not set
# CONFIG_PECI_INTERRUPT_DRIVEN is not set
# CONFIG_REGULATOR is not set
# CONFIG_MEMC is not set
# CONFIG_VIRTUALIZATION is not set
# CONFIG_EDAC is not set
# CONFIG_PM_CPU_OPS is not set

#
# Miscellaneous Drivers
#
# end of Miscellaneous Drivers

# CONFIG_DISK_DRIVERS is not set
# CONFIG_CACHE is not set
# CONFIG_SYSCON is not set
# CONFIG_BBRAM is not set
# CONFIG_FPGA is not set
# end of Device Drivers

#
# C Library
#
CONFIG_SUPPORT_MINIMAL_LIBC=y
# CONFIG_MINIMAL_LIBC is not set
CONFIG_NEWLIB_LIBC=y
# CONFIG_EXTERNAL_LIBC is not set
CONFIG_NEWLIB_LIBC_MAX_MAPPED_REGION_SIZE=1048576
CONFIG_NEWLIB_LIBC_MIN_REQUIRED_HEAP_SIZE=8192
CONFIG_NEWLIB_LIBC_FLOAT_PRINTF=y
CONFIG_NEWLIB_LIBC_FLOAT_SCANF=y
CONFIG_STDOUT_CONSOLE=y
# end of C Library

#
# Additional libraries
#
# CONFIG_LVGL is not set

#
# OS Support Library
#
# CONFIG_JSON_LIBRARY is not set
# CONFIG_RING_BUFFER is not set
# CONFIG_BASE64 is not set
# CONFIG_SYS_HEAP_VALIDATE is not set
CONFIG_SYS_HEAP_ALLOC_LOOPS=3
# CONFIG_PRINTK_SYNC is not set
# CONFIG_MPSC_PBUF is not set
# CONFIG_REBOOT is not set
CONFIG_CBPRINTF_COMPLETE=y
# CONFIG_CBPRINTF_NANO is not set
CONFIG_CBPRINTF_FULL_INTEGRAL=y
# CONFIG_CBPRINTF_REDUCED_INTEGRAL is not set
CONFIG_CBPRINTF_FP_SUPPORT=y
# CONFIG_CBPRINTF_FP_A_SUPPORT is not set
# CONFIG_CBPRINTF_FP_ALWAYS_A is not set
CONFIG_CBPRINTF_N_SPECIFIER=y
# CONFIG_CBPRINTF_LIBC_SUBSTS is not set
# CONFIG_CBPRINTF_PACKAGE_LONGDOUBLE is not set
# CONFIG_CBPRINTF_STATIC_PACKAGE_CHECK_ALIGNMENT is not set
# end of OS Support Library

CONFIG_POSIX_MAX_FDS=4
CONFIG_POSIX_API=y
CONFIG_PTHREAD_IPC=y
CONFIG_MAX_PTHREAD_COUNT=5
CONFIG_SEM_VALUE_MAX=32767
CONFIG_POSIX_CLOCK=y
CONFIG_MAX_TIMER_COUNT=5
# CONFIG_POSIX_MQUEUE is not set
CONFIG_POSIX_FS=y
CONFIG_POSIX_MAX_OPEN_FILES=16
CONFIG_APP_LINK_WITH_POSIX_SUBSYS=y
CONFIG_EVENTFD=y
CONFIG_EVENTFD_MAX=1
# CONFIG_OPENAMP_RSC_TABLE is not set

#
# Util libraries
#
# CONFIG_FNMATCH is not set
# CONFIG_GETOPT is not set
# end of Util libraries
# end of Additional libraries

#
# Sub Systems and OS Services
#
# CONFIG_BT is not set

#
# Controller Area Network (CAN) bus subsystem
#
# CONFIG_ISOTP is not set
# end of Controller Area Network (CAN) bus subsystem

# CONFIG_CONSOLE_SUBSYS is not set
# CONFIG_CPLUSPLUS is not set

#
# System Monitoring Options
#
# CONFIG_THREAD_ANALYZER is not set
# end of System Monitoring Options

#
# Debugging Options
#
# CONFIG_STACK_USAGE is not set
# CONFIG_STACK_SENTINEL is not set
CONFIG_PRINTK=y
CONFIG_EARLY_CONSOLE=y
# CONFIG_ASSERT is not set
# CONFIG_FORCE_NO_ASSERT is not set
CONFIG_ASSERT_VERBOSE=y
# CONFIG_ASSERT_NO_FILE_INFO is not set
# CONFIG_ASSERT_NO_COND_INFO is not set
# CONFIG_ASSERT_NO_MSG_INFO is not set
# CONFIG_OVERRIDE_FRAME_POINTER_DEFAULT is not set
# CONFIG_DEBUG_INFO is not set
# CONFIG_OPENOCD_SUPPORT is not set
# CONFIG_DEBUG_THREAD_INFO is not set
# end of Debugging Options

# CONFIG_DISK_ACCESS is not set
# CONFIG_EMUL is not set
# CONFIG_CHARACTER_FRAMEBUFFER is not set

#
# File Systems
#
CONFIG_FILE_SYSTEM=y
CONFIG_APP_LINK_WITH_FS=y
CONFIG_FILE_SYSTEM_MAX_TYPES=2
CONFIG_FILE_SYSTEM_MAX_FILE_NAME=-1
# CONFIG_FAT_FILESYSTEM_ELM is not set
# CONFIG_NVS is not set
# end of File Systems

#
# Inter Processor Communication
#
# CONFIG_RPMSG_SERVICE is not set
# CONFIG_RPMSG_MULTI_INSTANCE is not set
# CONFIG_IPC_SERVICE is not set
# end of Inter Processor Communication

# CONFIG_JWT is not set
# CONFIG_LOG is not set

#
# Device Management
#

#
# Host command handler subsystem
#
# CONFIG_EC_HOST_CMD is not set
# end of Host command handler subsystem

# CONFIG_MCUMGR is not set
# CONFIG_HAWKBIT is not set
# CONFIG_UPDATEHUB is not set
# CONFIG_OSDP is not set
# end of Device Management

# CONFIG_MODBUS is not set

#
# Networking
#
# CONFIG_NET_BUF is not set
# CONFIG_NETWORKING is not set
# end of Networking

#
# Portability
#
# end of Portability

#
# Power Management
#
# CONFIG_SYS_POWER_MANAGEMENT is not set
# CONFIG_PM is not set
# CONFIG_PM_DEVICE is not set
# CONFIG_DEVICE_POWER_MANAGEMENT is not set
# end of Power Management

# CONFIG_SHELL is not set
# CONFIG_STATS is not set
# CONFIG_USB_DEVICE_STACK is not set
# CONFIG_IMG_MANAGER is not set

#
# Random Number Generators
#
# CONFIG_TEST_RANDOM_GENERATOR is not set
# end of Random Number Generators

#
# Storage
#
# CONFIG_STREAM_FLASH is not set
# end of Storage

# CONFIG_SETTINGS is not set
# CONFIG_TASK_WDT is not set

#
# Testing
#
# CONFIG_ZTEST is not set
# CONFIG_ZTEST_MOCKING is not set
# CONFIG_TEST is not set
# CONFIG_TEST_USERSPACE is not set
# end of Testing

# CONFIG_TIMING_FUNCTIONS is not set
# CONFIG_TRACING is not set
# end of Sub Systems and OS Services

CONFIG_TOOLCHAIN_ZEPHYR_0_13=y

#
# Build and Link Features
#

#
# Linker Options
#
# CONFIG_LINKER_ORPHAN_SECTION_PLACE is not set
CONFIG_LINKER_ORPHAN_SECTION_WARN=y
# CONFIG_LINKER_ORPHAN_SECTION_ERROR is not set
CONFIG_HAS_FLASH_LOAD_OFFSET=y
# CONFIG_USE_DT_CODE_PARTITION is not set
CONFIG_FLASH_LOAD_OFFSET=0
CONFIG_FLASH_LOAD_SIZE=0
CONFIG_LD_LINKER_SCRIPT_SUPPORTED=y
CONFIG_LD_LINKER_TEMPLATE=y
# CONFIG_HAVE_CUSTOM_LINKER_SCRIPT is not set
CONFIG_KERNEL_ENTRY="__start"
CONFIG_LINKER_SORT_BY_ALIGNMENT=y
# CONFIG_SRAM_VECTOR_TABLE is not set
CONFIG_SRAM_OFFSET=0

#
# Linker Sections
#
# CONFIG_LINKER_USE_BOOT_SECTION is not set
# CONFIG_LINKER_USE_PINNED_SECTION is not set
CONFIG_LINKER_GENERIC_SECTIONS_PRESENT_AT_BOOT=y
# end of Linker Sections
# end of Linker Options

#
# Compiler Options
#
# CONFIG_CODING_GUIDELINE_CHECK is not set
# CONFIG_NATIVE_APPLICATION is not set
CONFIG_SIZE_OPTIMIZATIONS=y
# CONFIG_SPEED_OPTIMIZATIONS is not set
# CONFIG_DEBUG_OPTIMIZATIONS is not set
# CONFIG_NO_OPTIMIZATIONS is not set
CONFIG_COMPILER_COLOR_DIAGNOSTICS=y
CONFIG_COMPILER_OPT=""
# CONFIG_MISRA_SANE is not set
# end of Compiler Options

# CONFIG_ASSERT_ON_ERRORS is not set
# CONFIG_NO_RUNTIME_CHECKS is not set
CONFIG_RUNTIME_ERROR_CHECKS=y

#
# Build Options
#
CONFIG_KERNEL_BIN_NAME="zephyr"
CONFIG_OUTPUT_STAT=y
CONFIG_OUTPUT_DISASSEMBLY=y
# CONFIG_OUTPUT_DISASSEMBLE_ALL is not set
CONFIG_OUTPUT_PRINT_MEMORY_USAGE=y
# CONFIG_CLEANUP_INTERMEDIATE_FILES is not set
# CONFIG_BUILD_NO_GAP_FILL is not set
# CONFIG_BUILD_OUTPUT_HEX is not set
# CONFIG_BUILD_OUTPUT_EXE is not set
# CONFIG_BUILD_OUTPUT_S19 is not set
# CONFIG_BUILD_OUTPUT_UF2 is not set
# CONFIG_BUILD_OUTPUT_STRIPPED is not set
# CONFIG_APPLICATION_DEFINED_SYSCALL is not set
# CONFIG_MAKEFILE_EXPORTS is not set
# end of Build Options
# end of Build and Link Features

#
# Boot Options
#
# CONFIG_BOOTLOADER_MCUBOOT is not set
# CONFIG_BOOTLOADER_BOSSA is not set
# end of Boot Options

#
# Compatibility
#
CONFIG_COMPAT_INCLUDES=y
# end of Compatibility
```

## aarch64_kernel_config_relocated.conf
```kconfig
# CONFIG_GPIO is not set
# CONFIG_SPI is not set
# CONFIG_I2C is not set
# CONFIG_KSCAN is not set
# CONFIG_WIFI is not set
# CONFIG_MODEM is not set
CONFIG_UART_INTERRUPT_DRIVEN=y
CONFIG_BUILD_OUTPUT_BIN=y
CONFIG_BOARD="qemu_cortex_a53"
CONFIG_SYS_CLOCK_HW_CYCLES_PER_SEC=62500000
CONFIG_NUM_IRQS=220
CONFIG_SOC="qemu_cortex_a53"
CONFIG_FLASH_SIZE=65536
CONFIG_FLASH_BASE_ADDRESS=0x0

#
# Modules
#

#
# Available modules.
#

#
# CANopenNode (/home/ashwin/zephyrproject/modules/lib/canopennode)
#
CONFIG_ZEPHYR_CANOPENNODE_MODULE=y
# end of CANopenNode (/home/ashwin/zephyrproject/modules/lib/canopennode)

#
# hal_nordic (/home/ashwin/zephyrproject/modules/hal/nordic)
#
CONFIG_ZEPHYR_HAL_NORDIC_MODULE=y
# end of hal_nordic (/home/ashwin/zephyrproject/modules/hal/nordic)

#
# hal_nxp (/home/ashwin/zephyrproject/modules/hal/nxp)
#
CONFIG_ZEPHYR_HAL_NXP_MODULE=y
# end of hal_nxp (/home/ashwin/zephyrproject/modules/hal/nxp)

#
# loramac-node (/home/ashwin/zephyrproject/modules/lib/loramac-node)
#
CONFIG_ZEPHYR_LORAMAC_NODE_MODULE=y
# CONFIG_HAS_SEMTECH_RADIO_DRIVERS is not set
# end of loramac-node (/home/ashwin/zephyrproject/modules/lib/loramac-node)

#
# lz4 (/home/ashwin/zephyrproject/modules/lib/lz4)
#
CONFIG_ZEPHYR_LZ4_MODULE=y
# CONFIG_LZ4 is not set
# end of lz4 (/home/ashwin/zephyrproject/modules/lib/lz4)

#
# mbedtls (/home/ashwin/zephyrproject/modules/crypto/mbedtls)
#
CONFIG_ZEPHYR_MBEDTLS_MODULE=y
# CONFIG_MBEDTLS is not set
# end of mbedtls (/home/ashwin/zephyrproject/modules/crypto/mbedtls)

#
# nanopb (/home/ashwin/zephyrproject/modules/lib/nanopb)
#
CONFIG_ZEPHYR_NANOPB_MODULE=y
# CONFIG_NANOPB is not set
# end of nanopb (/home/ashwin/zephyrproject/modules/lib/nanopb)

#
# sof (/home/ashwin/zephyrproject/modules/audio/sof)
#
# CONFIG_DEBUG is not set
CONFIG_ZEPHYR_SOF_MODULE=y
# end of sof (/home/ashwin/zephyrproject/modules/audio/sof)

#
# tflite-micro (/home/ashwin/zephyrproject/modules/lib/tflite-micro)
#
# CONFIG_TENSORFLOW_LITE_MICRO is not set
CONFIG_ZEPHYR_TFLITE_MICRO_MODULE=y
# end of tflite-micro (/home/ashwin/zephyrproject/modules/lib/tflite-micro)

#
# TraceRecorder (/home/ashwin/zephyrproject/modules/debug/TraceRecorder)
#
CONFIG_ZEPHYR_TRACERECORDER_MODULE=y
# end of TraceRecorder (/home/ashwin/zephyrproject/modules/debug/TraceRecorder)

#
# trusted-firmware-m (/home/ashwin/zephyrproject/modules/tee/tfm)
#
CONFIG_ZEPHYR_TRUSTED_FIRMWARE_M_MODULE=y
CONFIG_ROM_START_OFFSET=0
# end of trusted-firmware-m (/home/ashwin/zephyrproject/modules/tee/tfm)

#
# Optional modules. Make sure they're installed, via the project manifest.
#
# CONFIG_CIVETWEB is not set
# CONFIG_CMSIS_DSP is not set
# CONFIG_LIBMETAL is not set
# CONFIG_HAS_MEC_HAL is not set
# CONFIG_OPENAMP is not set
# CONFIG_SOF is not set
# CONFIG_MIPI_SYST_LIB is not set
# CONFIG_HAS_TELINK_DRIVERS is not set
# CONFIG_TINYCBOR is not set
# CONFIG_TINYCRYPT is not set
# CONFIG_MCUBOOT_BOOTUTIL_LIB is not set

#
# Unavailable modules, please install those via the project manifest.
#
# end of Modules

CONFIG_QEMU_TARGET=y
CONFIG_BOARD_QEMU_CORTEX_A53=y

#
# Board Options
#
# CONFIG_QEMU_ICOUNT is not set
# end of Board Options

# CONFIG_SOC_SERIES_FVP_AEMV8A is not set
# CONFIG_SOC_SERIES_FVP_AEMV8R is not set
# CONFIG_SOC_SERIES_VIPER is not set
# CONFIG_SOC_SERIES_LS1046A is not set
CONFIG_SOC_QEMU_CORTEX_A53=y
# CONFIG_SOC_XENVM is not set

#
# Hardware Configuration
#
# end of Hardware Configuration

#
# ARM64 Options
#
CONFIG_ARCH="arm64"
CONFIG_CPU_CORTEX=y
CONFIG_CPU_CORTEX_A=y
CONFIG_CPU_CORTEX_A53=y
CONFIG_HAS_ARM_SMCCC=y
CONFIG_MAIN_STACK_SIZE=4096
CONFIG_IDLE_STACK_SIZE=4096
CONFIG_ISR_STACK_SIZE=4096
CONFIG_TEST_EXTRA_STACKSIZE=2048
CONFIG_SYSTEM_WORKQUEUE_STACK_SIZE=4096
CONFIG_CMSIS_THREAD_MAX_STACK_SIZE=4096
CONFIG_CMSIS_V2_THREAD_MAX_STACK_SIZE=4096
CONFIG_CMSIS_V2_THREAD_DYNAMIC_STACK_SIZE=4096
CONFIG_IPM_CONSOLE_STACK_SIZE=2048
CONFIG_AARCH64_IMAGE_HEADER=y
CONFIG_PRIVILEGED_STACK_SIZE=4096
CONFIG_KOBJECT_TEXT_AREA=256
CONFIG_ARMV8_A_NS=y
CONFIG_ARMV8_A=y
CONFIG_GEN_ISR_TABLES=y
# CONFIG_GEN_IRQ_VECTOR_TABLE is not set
CONFIG_ARM_MMU=y
# CONFIG_XIP is not set
CONFIG_MMU_PAGE_SIZE=0x1000
CONFIG_ARM64_VA_BITS_32=y
# CONFIG_ARM64_VA_BITS_36 is not set
# CONFIG_ARM64_VA_BITS_40 is not set
# CONFIG_ARM64_VA_BITS_42 is not set
# CONFIG_ARM64_VA_BITS_48 is not set
CONFIG_ARM64_VA_BITS=32
CONFIG_ARM64_PA_BITS_32=y
# CONFIG_ARM64_PA_BITS_36 is not set
# CONFIG_ARM64_PA_BITS_40 is not set
# CONFIG_ARM64_PA_BITS_42 is not set
# CONFIG_ARM64_PA_BITS_48 is not set
CONFIG_ARM64_PA_BITS=32
CONFIG_MAX_XLAT_TABLES=8
# end of ARM64 Options

CONFIG_ARM64=y
CONFIG_ARCH_IS_SET=y

#
# General Architecture Options
#
CONFIG_64BIT=y
CONFIG_SRAM_SIZE=131072
CONFIG_SRAM_BASE_ADDRESS=0x50000000
# CONFIG_USERSPACE is not set
CONFIG_KOBJECT_DATA_AREA_RESERVE_EXTRA_PERCENT=100
CONFIG_KOBJECT_RODATA_AREA_EXTRA_BYTES=16
# CONFIG_STACK_GROWS_UP is not set

#
# Interrupt Configuration
#
# CONFIG_DYNAMIC_INTERRUPTS is not set
CONFIG_GEN_SW_ISR_TABLE=y
CONFIG_ARCH_SW_ISR_TABLE_ALIGN=0
CONFIG_GEN_IRQ_START_VECTOR=0
# end of Interrupt Configuration
# end of General Architecture Options

CONFIG_ARCH_HAS_USERSPACE=y
CONFIG_ARCH_HAS_THREAD_LOCAL_STORAGE=y
CONFIG_CPU_HAS_FPU=y
CONFIG_CPU_HAS_MMU=y
CONFIG_MMU=y
CONFIG_KERNEL_VM_BASE=0x50000000
CONFIG_KERNEL_VM_OFFSET=0
CONFIG_KERNEL_VM_SIZE=0x800000
CONFIG_SRAM_REGION_PERMISSIONS=y

#
# Floating Point Options
#
CONFIG_FPU=y
CONFIG_FPU_SHARING=y
# end of Floating Point Options

#
# Cache Options
#
CONFIG_CACHE_MANAGEMENT=y
# CONFIG_DCACHE_LINE_SIZE_DETECT is not set
CONFIG_DCACHE_LINE_SIZE=0
# CONFIG_ICACHE_LINE_SIZE_DETECT is not set
CONFIG_ICACHE_LINE_SIZE=0
CONFIG_HAS_ARCH_CACHE=y
# CONFIG_HAS_EXTERNAL_CACHE is not set
# end of Cache Options

CONFIG_TOOLCHAIN_HAS_BUILTIN_FFS=y

#
# General Kernel Options
#
CONFIG_MULTITHREADING=y
CONFIG_NUM_COOP_PRIORITIES=16
CONFIG_NUM_PREEMPT_PRIORITIES=15
CONFIG_MAIN_THREAD_PRIORITY=0
CONFIG_COOP_ENABLED=y
CONFIG_PREEMPT_ENABLED=y
CONFIG_PRIORITY_CEILING=-127
CONFIG_NUM_METAIRQ_PRIORITIES=0
# CONFIG_SCHED_DEADLINE is not set
# CONFIG_SCHED_CPU_MASK is not set
# CONFIG_THREAD_STACK_INFO is not set
# CONFIG_THREAD_CUSTOM_DATA is not set
CONFIG_ERRNO=y
CONFIG_SCHED_DUMB=y
# CONFIG_SCHED_SCALABLE is not set
# CONFIG_SCHED_MULTIQ is not set
# CONFIG_WAITQ_SCALABLE is not set
CONFIG_WAITQ_DUMB=y

#
# Kernel Debugging and Metrics
#
# CONFIG_INIT_STACKS is not set
CONFIG_BOOT_BANNER=y
CONFIG_BOOT_DELAY=0
CONFIG_THREAD_MONITOR=y
CONFIG_THREAD_NAME=y
CONFIG_THREAD_MAX_NAME_LEN=32
# CONFIG_THREAD_RUNTIME_STATS is not set
# end of Kernel Debugging and Metrics

#
# Work Queue Options
#
CONFIG_SYSTEM_WORKQUEUE_PRIORITY=-1
# CONFIG_SYSTEM_WORKQUEUE_NO_YIELD is not set
# end of Work Queue Options

#
# Atomic Operations
#
CONFIG_ATOMIC_OPERATIONS_BUILTIN=y
# end of Atomic Operations

#
# Timer API Options
#
CONFIG_TIMESLICING=y
CONFIG_TIMESLICE_SIZE=0
CONFIG_TIMESLICE_PRIORITY=0
# CONFIG_POLL is not set
# end of Timer API Options

#
# Other Kernel Object Options
#
CONFIG_MEM_SLAB_TRACE_MAX_UTILIZATION=y
CONFIG_NUM_MBOX_ASYNC_MSGS=10
CONFIG_NUM_PIPE_ASYNC_MSGS=10
CONFIG_KERNEL_MEM_POOL=y
CONFIG_HEAP_MEM_POOL_SIZE=1449616
# end of Other Kernel Object Options

CONFIG_ARCH_HAS_CUSTOM_BUSY_WAIT=y
CONFIG_SYS_CLOCK_TICKS_PER_SEC=100
CONFIG_SYS_CLOCK_EXISTS=y
CONFIG_TIMEOUT_64BIT=y

#
# Initialization Priorities
#
CONFIG_KERNEL_INIT_PRIORITY_OBJECTS=30
CONFIG_KERNEL_INIT_PRIORITY_DEFAULT=40
CONFIG_KERNEL_INIT_PRIORITY_DEVICE=50
CONFIG_APPLICATION_INIT_PRIORITY=90
# end of Initialization Priorities

#
# Security Options
#
# end of Security Options

#
# SMP Options
#
CONFIG_USE_SWITCH=y
CONFIG_USE_SWITCH_SUPPORTED=y
# CONFIG_SMP is not set
CONFIG_MP_NUM_CPUS=1
# end of SMP Options

CONFIG_TICKLESS_KERNEL=y
# end of General Kernel Options

CONFIG_HAS_DTS=y

#
# Device Drivers
#
# CONFIG_IEEE802154 is not set
# CONFIG_LORA is not set
CONFIG_CONSOLE=y
CONFIG_CONSOLE_INPUT_MAX_LINE_LEN=128
CONFIG_CONSOLE_HAS_DRIVER=y
# CONFIG_CONSOLE_HANDLER is not set
CONFIG_UART_CONSOLE=y
CONFIG_UART_CONSOLE_INIT_PRIORITY=60
# CONFIG_UART_CONSOLE_DEBUG_SERVER_HOOKS is not set
# CONFIG_UART_CONSOLE_MCUMGR is not set
# CONFIG_USB_UART_CONSOLE is not set
# CONFIG_RAM_CONSOLE is not set
# CONFIG_IPM_CONSOLE_SENDER is not set
# CONFIG_IPM_CONSOLE_RECEIVER is not set
# CONFIG_UART_PIPE is not set
# CONFIG_UART_MCUMGR is not set
# CONFIG_SEMIHOST_CONSOLE is not set
# CONFIG_GSM_MUX is not set
# CONFIG_EC_HOST_CMD_PERIPH is not set
# CONFIG_MDIO is not set
# CONFIG_NET_LOOPBACK is not set
CONFIG_SERIAL=y

#
# Capabilities
#
CONFIG_SERIAL_HAS_DRIVER=y
CONFIG_SERIAL_SUPPORT_INTERRUPT=y
CONFIG_UART_USE_RUNTIME_CONFIGURE=y
# CONFIG_UART_LINE_CTRL is not set
# CONFIG_UART_DRV_CMD is not set

#
# Serial Drivers
#
# CONFIG_UART_NS16550 is not set
# CONFIG_UART_ALTERA_JTAG is not set
CONFIG_UART_PL011=y
CONFIG_UART_PL011_PORT0=y
# CONFIG_UART_PL011_PORT1 is not set
# CONFIG_UART_PL011_SBSA is not set
# CONFIG_UART_XLNX_UARTLITE is not set

#
# Interrupt Controllers
#
# CONFIG_SWERV_PIC is not set
# CONFIG_MULTI_LEVEL_INTERRUPTS is not set
CONFIG_GIC=y
CONFIG_GIC_V3=y
CONFIG_GIC_VER=3
# CONFIG_INTC_ESP32 is not set
# end of Interrupt Controllers

#
# Timer Drivers
#
# CONFIG_HPET_TIMER is not set
CONFIG_ARM_ARCH_TIMER=y
# CONFIG_SYSTEM_CLOCK_DISABLE is not set
# CONFIG_TIMER_READS_ITS_FREQUENCY_AT_RUNTIME is not set
# CONFIG_SYSTEM_CLOCK_SLOPPY_IDLE is not set
CONFIG_SYSTEM_CLOCK_INIT_PRIORITY=0
CONFIG_TICKLESS_CAPABLE=y
# end of Timer Drivers

# CONFIG_ENTROPY_GENERATOR is not set
# CONFIG_PCIE is not set
# CONFIG_PCIE_ENDPOINT is not set
# CONFIG_SHARED_IRQ is not set
# CONFIG_I2S is not set
# CONFIG_PWM is not set
# CONFIG_PINMUX is not set
# CONFIG_ADC is not set
# CONFIG_DAC is not set
# CONFIG_WATCHDOG is not set
# CONFIG_CLOCK_CONTROL is not set
# CONFIG_PTP_CLOCK is not set
# CONFIG_IPM is not set
# CONFIG_FLASH is not set
# CONFIG_SENSOR is not set
# CONFIG_COUNTER is not set
# CONFIG_DMA is not set
# CONFIG_USB_DEVICE_DRIVER is not set
# CONFIG_CRYPTO is not set
# CONFIG_DISPLAY is not set
# CONFIG_LED_STRIP is not set
# CONFIG_LED is not set
# CONFIG_CAN is not set
# CONFIG_AUDIO is not set
# CONFIG_NEURAL_NET_ACCEL is not set
# CONFIG_HWINFO is not set
# CONFIG_ESPI is not set
# CONFIG_PS2 is not set
# CONFIG_VIDEO is not set
# CONFIG_EEPROM is not set
# CONFIG_PECI is not set
# CONFIG_PECI_INTERRUPT_DRIVEN is not set
# CONFIG_REGULATOR is not set
# CONFIG_MEMC is not set
# CONFIG_VIRTUALIZATION is not set
# CONFIG_EDAC is not set
# CONFIG_PM_CPU_OPS is not set

#
# Miscellaneous Drivers
#
# end of Miscellaneous Drivers

# CONFIG_DISK_DRIVERS is not set
# CONFIG_CACHE is not set
# CONFIG_SYSCON is not set
# CONFIG_BBRAM is not set
# CONFIG_FPGA is not set
# end of Device Drivers

#
# C Library
#
CONFIG_SUPPORT_MINIMAL_LIBC=y
# CONFIG_MINIMAL_LIBC is not set
CONFIG_NEWLIB_LIBC=y
# CONFIG_EXTERNAL_LIBC is not set
CONFIG_NEWLIB_LIBC_MAX_MAPPED_REGION_SIZE=1048576
CONFIG_NEWLIB_LIBC_MIN_REQUIRED_HEAP_SIZE=8192
CONFIG_NEWLIB_LIBC_FLOAT_PRINTF=y
CONFIG_NEWLIB_LIBC_FLOAT_SCANF=y
CONFIG_STDOUT_CONSOLE=y
# end of C Library

#
# Additional libraries
#
# CONFIG_LVGL is not set

#
# OS Support Library
#
# CONFIG_JSON_LIBRARY is not set
# CONFIG_RING_BUFFER is not set
# CONFIG_BASE64 is not set
# CONFIG_SYS_HEAP_VALIDATE is not set
CONFIG_SYS_HEAP_ALLOC_LOOPS=3
# CONFIG_PRINTK_SYNC is not set
# CONFIG_MPSC_PBUF is not set
# CONFIG_REBOOT is not set
CONFIG_CBPRINTF_COMPLETE=y
# CONFIG_CBPRINTF_NANO is not set
CONFIG_CBPRINTF_FULL_INTEGRAL=y
# CONFIG_CBPRINTF_REDUCED_INTEGRAL is not set
CONFIG_CBPRINTF_FP_SUPPORT=y
# CONFIG_CBPRINTF_FP_A_SUPPORT is not set
# CONFIG_CBPRINTF_FP_ALWAYS_A is not set
CONFIG_CBPRINTF_N_SPECIFIER=y
# CONFIG_CBPRINTF_LIBC_SUBSTS is not set
# CONFIG_CBPRINTF_PACKAGE_LONGDOUBLE is not set
# CONFIG_CBPRINTF_STATIC_PACKAGE_CHECK_ALIGNMENT is not set
# end of OS Support Library

CONFIG_POSIX_MAX_FDS=4
CONFIG_POSIX_API=y
CONFIG_PTHREAD_IPC=y
CONFIG_MAX_PTHREAD_COUNT=5
CONFIG_SEM_VALUE_MAX=32767
CONFIG_POSIX_CLOCK=y
CONFIG_MAX_TIMER_COUNT=5
# CONFIG_POSIX_MQUEUE is not set
CONFIG_POSIX_FS=y
CONFIG_POSIX_MAX_OPEN_FILES=16
CONFIG_APP_LINK_WITH_POSIX_SUBSYS=y
CONFIG_EVENTFD=y
CONFIG_EVENTFD_MAX=1
# CONFIG_OPENAMP_RSC_TABLE is not set

#
# Util libraries
#
# CONFIG_FNMATCH is not set
# CONFIG_GETOPT is not set
# end of Util libraries
# end of Additional libraries

#
# Sub Systems and OS Services
#
# CONFIG_BT is not set

#
# Controller Area Network (CAN) bus subsystem
#
# CONFIG_ISOTP is not set
# end of Controller Area Network (CAN) bus subsystem

# CONFIG_CONSOLE_SUBSYS is not set
# CONFIG_CPLUSPLUS is not set

#
# System Monitoring Options
#
# CONFIG_THREAD_ANALYZER is not set
# end of System Monitoring Options

#
# Debugging Options
#
# CONFIG_STACK_USAGE is not set
# CONFIG_STACK_SENTINEL is not set
CONFIG_PRINTK=y
CONFIG_EARLY_CONSOLE=y
# CONFIG_ASSERT is not set
# CONFIG_FORCE_NO_ASSERT is not set
CONFIG_ASSERT_VERBOSE=y
# CONFIG_ASSERT_NO_FILE_INFO is not set
# CONFIG_ASSERT_NO_COND_INFO is not set
# CONFIG_ASSERT_NO_MSG_INFO is not set
# CONFIG_OVERRIDE_FRAME_POINTER_DEFAULT is not set
# CONFIG_DEBUG_INFO is not set
# CONFIG_OPENOCD_SUPPORT is not set
# CONFIG_DEBUG_THREAD_INFO is not set
# end of Debugging Options

# CONFIG_DISK_ACCESS is not set
# CONFIG_EMUL is not set
# CONFIG_CHARACTER_FRAMEBUFFER is not set

#
# File Systems
#
CONFIG_FILE_SYSTEM=y
CONFIG_APP_LINK_WITH_FS=y
CONFIG_FILE_SYSTEM_MAX_TYPES=2
CONFIG_FILE_SYSTEM_MAX_FILE_NAME=-1
# CONFIG_FAT_FILESYSTEM_ELM is not set
# CONFIG_NVS is not set
# end of File Systems

#
# Inter Processor Communication
#
# CONFIG_RPMSG_SERVICE is not set
# CONFIG_RPMSG_MULTI_INSTANCE is not set
# CONFIG_IPC_SERVICE is not set
# end of Inter Processor Communication

# CONFIG_JWT is not set
# CONFIG_LOG is not set

#
# Device Management
#

#
# Host command handler subsystem
#
# CONFIG_EC_HOST_CMD is not set
# end of Host command handler subsystem

# CONFIG_MCUMGR is not set
# CONFIG_HAWKBIT is not set
# CONFIG_UPDATEHUB is not set
# CONFIG_OSDP is not set
# end of Device Management

# CONFIG_MODBUS is not set

#
# Networking
#
# CONFIG_NET_BUF is not set
# CONFIG_NETWORKING is not set
# end of Networking

#
# Portability
#
# end of Portability

#
# Power Management
#
# CONFIG_SYS_POWER_MANAGEMENT is not set
# CONFIG_PM is not set
# CONFIG_PM_DEVICE is not set
# CONFIG_DEVICE_POWER_MANAGEMENT is not set
# end of Power Management

# CONFIG_SHELL is not set
# CONFIG_STATS is not set
# CONFIG_USB_DEVICE_STACK is not set
# CONFIG_IMG_MANAGER is not set

#
# Random Number Generators
#
# CONFIG_TEST_RANDOM_GENERATOR is not set
# end of Random Number Generators

#
# Storage
#
# CONFIG_STREAM_FLASH is not set
# end of Storage

# CONFIG_SETTINGS is not set
# CONFIG_TASK_WDT is not set

#
# Testing
#
# CONFIG_ZTEST is not set
# CONFIG_ZTEST_MOCKING is not set
# CONFIG_TEST is not set
# CONFIG_TEST_USERSPACE is not set
# end of Testing

# CONFIG_TIMING_FUNCTIONS is not set
# CONFIG_TRACING is not set
# end of Sub Systems and OS Services

CONFIG_TOOLCHAIN_ZEPHYR_0_13=y

#
# Build and Link Features
#

#
# Linker Options
#
# CONFIG_LINKER_ORPHAN_SECTION_PLACE is not set
CONFIG_LINKER_ORPHAN_SECTION_WARN=y
# CONFIG_LINKER_ORPHAN_SECTION_ERROR is not set
CONFIG_HAS_FLASH_LOAD_OFFSET=y
# CONFIG_USE_DT_CODE_PARTITION is not set
CONFIG_FLASH_LOAD_OFFSET=0
CONFIG_FLASH_LOAD_SIZE=0
CONFIG_LD_LINKER_SCRIPT_SUPPORTED=y
CONFIG_LD_LINKER_TEMPLATE=y
# CONFIG_HAVE_CUSTOM_LINKER_SCRIPT is not set
CONFIG_KERNEL_ENTRY="__start"
CONFIG_LINKER_SORT_BY_ALIGNMENT=y
# CONFIG_SRAM_VECTOR_TABLE is not set
CONFIG_SRAM_OFFSET=0

#
# Linker Sections
#
# CONFIG_LINKER_USE_BOOT_SECTION is not set
# CONFIG_LINKER_USE_PINNED_SECTION is not set
CONFIG_LINKER_GENERIC_SECTIONS_PRESENT_AT_BOOT=y
# end of Linker Sections
# end of Linker Options

#
# Compiler Options
#
# CONFIG_CODING_GUIDELINE_CHECK is not set
# CONFIG_NATIVE_APPLICATION is not set
CONFIG_SIZE_OPTIMIZATIONS=y
# CONFIG_SPEED_OPTIMIZATIONS is not set
# CONFIG_DEBUG_OPTIMIZATIONS is not set
# CONFIG_NO_OPTIMIZATIONS is not set
CONFIG_COMPILER_COLOR_DIAGNOSTICS=y
CONFIG_COMPILER_OPT=""
# CONFIG_MISRA_SANE is not set
# end of Compiler Options

# CONFIG_ASSERT_ON_ERRORS is not set
# CONFIG_NO_RUNTIME_CHECKS is not set
CONFIG_RUNTIME_ERROR_CHECKS=y

#
# Build Options
#
CONFIG_KERNEL_BIN_NAME="zephyr"
CONFIG_OUTPUT_STAT=y
CONFIG_OUTPUT_DISASSEMBLY=y
# CONFIG_OUTPUT_DISASSEMBLE_ALL is not set
CONFIG_OUTPUT_PRINT_MEMORY_USAGE=y
# CONFIG_CLEANUP_INTERMEDIATE_FILES is not set
# CONFIG_BUILD_NO_GAP_FILL is not set
# CONFIG_BUILD_OUTPUT_HEX is not set
# CONFIG_BUILD_OUTPUT_EXE is not set
# CONFIG_BUILD_OUTPUT_S19 is not set
# CONFIG_BUILD_OUTPUT_UF2 is not set
# CONFIG_BUILD_OUTPUT_STRIPPED is not set
# CONFIG_APPLICATION_DEFINED_SYSCALL is not set
# CONFIG_MAKEFILE_EXPORTS is not set
# end of Build Options
# end of Build and Link Features

#
# Boot Options
#
# CONFIG_BOOTLOADER_MCUBOOT is not set
# CONFIG_BOOTLOADER_BOSSA is not set
# end of Boot Options

#
# Compatibility
#
CONFIG_COMPAT_INCLUDES=y
# end of Compatibility
```

## src/ep.c
```c
//-------------------------------------------------------------------------//
//                                                                         //
//  This benchmark is a serial C version of the NPB EP code. This C        //
//  version is developed by the Center for Manycore Programming at Seoul   //
//  National University and derived from the serial Fortran versions in    //
//  "NPB3.3-SER" developed by NAS.                                         //
//                                                                         //
//  Permission to use, copy, distribute and modify this software for any   //
//  purpose with or without fee is hereby granted. This software is        //
//  provided "as is" without express or implied warranty.                  //
//                                                                         //
//  Information on NPB 3.3, including the technical report, the original   //
//  specifications, source code, results and information on how to submit  //
//  new results, is available at:                                          //
//                                                                         //
//           http://www.nas.nasa.gov/Software/NPB/                         //
//                                                                         //
//  Send comments or suggestions for this C version to cmp@aces.snu.ac.kr  //
//                                                                         //
//          Center for Manycore Programming                                //
//          School of Computer Science and Engineering                     //
//          Seoul National University                                      //
//          Seoul 151-744, Korea                                           //
//                                                                         //
//          E-mail:  cmp@aces.snu.ac.kr                                    //
//                                                                         //
//-------------------------------------------------------------------------//

//-------------------------------------------------------------------------//
// Authors: Sangmin Seo, Jungwon Kim, Jun Lee, Jeongho Nah, Gangwon Jo,    //
//          and Jaejin Lee                                                 //
//-------------------------------------------------------------------------//

//--------------------------------------------------------------------
//      program EMBAR
//--------------------------------------------------------------------
//  This is the serial version of the APP Benchmark 1,
//  the "embarassingly parallel" benchmark.
//
//
//  M is the Log_2 of the number of complex pairs of uniform (0, 1) random
//  numbers.  MK is the Log_2 of the size of each batch of uniform random
//  numbers.  MK can be set for convenience on a given system, since it does
//  not affect the results.
//--------------------------------------------------------------------

#include <stdio.h>
#include <stdlib.h>
#include <math.h>
#include "type.h"
#include "npbparams.h"
#include "randdp.h"
#include "timers.h"
#include "print_results.h"

#define MAX(X,Y)  (((X) > (Y)) ? (X) : (Y))

#define MK        16
#define MM        (M - MK)
#define NN        (1 << MM)
#define NK        (1 << MK)
#define NQ        10
#define EPSILON   1.0e-8
#define A         1220703125.0
#define S         271828183.0

static double x[2*NK];
static double q[NQ]; 


int main() 
{
  double Mops, t1, t2, t3, t4, x1, x2;
  double sx, sy, tm, an, tt, gc;
  double sx_verify_value, sy_verify_value, sx_err, sy_err;
  int    np;
  int    i, ik, kk, l, k, nit;
  int    k_offset, j;
  logical verified, timers_enabled;
  double dum[3] = {1.0, 1.0, 1.0};
  char   size[16];

  FILE *fp;
  void * temp;
  if ((fp = fopen("timer.flag", "r")) == NULL) {
    timers_enabled = false;
  } else {
    timers_enabled = true;
    fclose(fp);
  }

  //--------------------------------------------------------------------
  //  Because the size of the problem is too large to store in a 32-bit
  //  integer for some classes, we put it into a string (for printing).
  //  Have to strip off the decimal point put in there by the floating
  //  point print statement (internal file)
  //--------------------------------------------------------------------

  sprintf(size, "%15.0lf", pow(2.0, M+1));
  j = 14;
  if (size[j] == '.') j--;
  size[j+1] = '\0';
  printf("\n\n NAS Parallel Benchmarks (NPB3.3-SER-C) - EP Benchmark\n");
  printf("\n Number of random numbers generated: %15s\n", size);
  temp = (int *)malloc(100000);
  printf("\n allocated memory at %p\n",temp);
  *(int *)temp = 0x0;
  printf("\nWrtoe into allocated memory\n");
  verified = false;

  //--------------------------------------------------------------------
  //  Compute the number of "batches" of random number pairs generated 
  //  per processor. Adjust if the number of processors does not evenly 
  //  divide the total number
  //--------------------------------------------------------------------

  np = NN; 

  //--------------------------------------------------------------------
  //  Call the random number generator functions and initialize
  //  the x-array to reduce the effects of paging on the timings.
  //  Also, call all mathematical functions that are used. Make
  //  sure these initializations cannot be eliminated as dead code.
  //--------------------------------------------------------------------

  vranlc(0, &dum[0], dum[1], &dum[2]);
  dum[0] = randlc(&dum[1], dum[2]);
  for (i = 0; i < 2 * NK; i++) {
    x[i] = -1.0e99;
  }
  Mops = log(sqrt(fabs(MAX(1.0, 1.0))));   

  timer_clear(0);
  timer_clear(1);
  timer_clear(2);
  timer_start(0);


  t1 = A;
  vranlc(0, &t1, A, x);

  //--------------------------------------------------------------------
  //  Compute AN = A ^ (2 * NK) (mod 2^46).
  //--------------------------------------------------------------------

  t1 = A;

  for (i = 0; i < MK + 1; i++) {
    t2 = randlc(&t1, t1);
  }

  an = t1;
  tt = S;
  gc = 0.0;
  sx = 0.0;
  sy = 0.0;

  for (i = 0; i < NQ; i++) {
    q[i] = 0.0;
  }

  //--------------------------------------------------------------------
  //  Each instance of this loop may be performed independently. We compute
  //  the k offsets separately to take into account the fact that some nodes
  //  have more numbers to generate than others
  //--------------------------------------------------------------------

  k_offset = -1;

  for (k = 1; k <= np; k++) {
    kk = k_offset + k; 
    t1 = S;
    t2 = an;

    // Find starting seed t1 for this kk.

    for (i = 1; i <= 100; i++) {
      ik = kk / 2;
      if ((2 * ik) != kk) t3 = randlc(&t1, t2);
      if (ik == 0) break;
      t3 = randlc(&t2, t2);
      kk = ik;
    }

    //--------------------------------------------------------------------
    //  Compute uniform pseudorandom numbers.
    //--------------------------------------------------------------------
    if (timers_enabled) timer_start(2);
    vranlc(2 * NK, &t1, A, x);
    if (timers_enabled) timer_stop(2);

    //--------------------------------------------------------------------
    //  Compute Gaussian deviates by acceptance-rejection method and 
    //  tally counts in concentri//square annuli.  This loop is not 
    //  vectorizable. 
    //--------------------------------------------------------------------
    if (timers_enabled) timer_start(1);

    for (i = 0; i < NK; i++) {
      x1 = 2.0 * x[2*i] - 1.0;
      x2 = 2.0 * x[2*i+1] - 1.0;
      t1 = x1 * x1 + x2 * x2;
      if (t1 <= 1.0) {
        t2   = sqrt(-2.0 * log(t1) / t1);
        t3   = (x1 * t2);
        t4   = (x2 * t2);
        l    = MAX(fabs(t3), fabs(t4));
        q[l] = q[l] + 1.0;
        sx   = sx + t3;
        sy   = sy + t4;
      }
    }

    if (timers_enabled) timer_stop(1);
  }

  for (i = 0; i < NQ; i++) {
    gc = gc + q[i];
  }


  timer_stop(0);
  tm = timer_read(0);

  nit = 0;
  verified = true;
  if (M == 24) {
    sx_verify_value = -3.247834652034740e+3;
    sy_verify_value = -6.958407078382297e+3;
  } else if (M == 25) {
    sx_verify_value = -2.863319731645753e+3;
    sy_verify_value = -6.320053679109499e+3;
  } else if (M == 28) {
    sx_verify_value = -4.295875165629892e+3;
    sy_verify_value = -1.580732573678431e+4;
  } else if (M == 30) {
    sx_verify_value =  4.033815542441498e+4;
    sy_verify_value = -2.660669192809235e+4;
  } else if (M == 32) {
    sx_verify_value =  4.764367927995374e+4;
    sy_verify_value = -8.084072988043731e+4;
  } else if (M == 36) {
    sx_verify_value =  1.982481200946593e+5;
    sy_verify_value = -1.020596636361769e+5;
  } else if (M == 40) {
    sx_verify_value = -5.319717441530e+05;
    sy_verify_value = -3.688834557731e+05;
  } else {
    verified = false;
  }

  if (verified) {
    sx_err = fabs((sx - sx_verify_value) / sx_verify_value);
    sy_err = fabs((sy - sy_verify_value) / sy_verify_value);
    verified = ((sx_err <= EPSILON) && (sy_err <= EPSILON));
  }

  Mops = pow(2.0, M+1) / tm / 1000000.0;

  printf("\nEP Benchmark Results:\n\n");
  printf("CPU Time =%10.4lf\n", tm);
  printf("N = 2^%5d\n", M);
  printf("No. Gaussian Pairs = %15.0lf\n", gc);
  printf("Sums = %25.15lE %25.15lE\n", sx, sy);
  printf("Counts: \n");
  for (i = 0; i < NQ; i++) {
    printf("%3d%15.0lf\n", i, q[i]);
  }

  print_results("EP", CLASS, M+1, 0, 0, nit,
      tm, Mops, 
      "Random numbers generated",
      verified, NPBVERSION, COMPILETIME, CS1,
      CS2, CS3, CS4, CS5, CS6, CS7);

  if (timers_enabled) {
    if (tm <= 0.0) tm = 1.0;
    tt = timer_read(0);
    printf("\nTotal time:     %9.3lf (%6.2lf)\n", tt, tt*100.0/tm);
    tt = timer_read(1);
    printf("Gaussian pairs: %9.3lf (%6.2lf)\n", tt, tt*100.0/tm);
    tt = timer_read(2);
    printf("Random numbers: %9.3lf (%6.2lf)\n", tt, tt*100.0/tm);
  }

  return 0;
}
```

## src/npbparams-A.h
```c
/* CLASS = A */
/*
   This file is generated automatically by the setparams utility.
   It sets the number of processors and the class of the NPB
   in this directory. Do not modify it by hand.   
*/
#define CLASS  'A'
#define M      28

#define CONVERTDOUBLE  false
#define COMPILETIME "03 Nov 2017"
#define NPBVERSION "3.3.1"
#define CS1 "gcc"
#define CS2 "$(CC)"
#define CS3 "-lm"
#define CS4 "-I../common"
#define CS5 "-g -Wall -O3 -mcmodel=medium"
#define CS6 "-O3 -mcmodel=medium"
#define CS7 "randdp"
```

## src/npbparams-S.h
```c
/* CLASS = S */
/*
   This file is generated automatically by the setparams utility.
   It sets the number of processors and the class of the NPB
   in this directory. Do not modify it by hand.   
*/
#define CLASS  'S'
#define M      24

#define CONVERTDOUBLE  false
#define COMPILETIME "03 Nov 2017"
#define NPBVERSION "3.3.1"
#define CS1 "gcc"
#define CS2 "$(CC)"
#define CS3 "-lm"
#define CS4 "-I../common"
#define CS5 "-g -Wall -O3 -mcmodel=medium"
#define CS6 "-O3 -mcmodel=medium"
#define CS7 "randdp"
```
