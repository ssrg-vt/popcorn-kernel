## prj.conf
```kconfig
CONFIG_STACK_CANARIES=n
CONFIG_INIT_STACKS=y
CONFIG_USERSPACE=y
#CONFIG_ZTEST=y
CONFIG_TEST_USERSPACE=y

CONFIG_NEWLIB_LIBC=y

#CONFIG_PCIE=y
#CONFIG_PCIE_MSI=y
#CONFIG_PCIE_MSI_X=y
#CONFIG_PCIE_MSI_MULTI_VECTOR=y

#CONFIG_TEST_EXTRA_STACKSIZE=32768

#CONFIG_VIRTUALIZATION=y
#CONFIG_IVSHMEM=y
```

## src/app.c
```c
#include "md5_bmark.h"
#include <zephyr.h>
#include <drivers/virtualization/ivshmem.h>
#include <stdio.h>
#include <pthread.h>
#include "rbtree.h"

extern int *  next_buf ;

#define BASE_SHMEM 0x60000000
#define SIZE_SHMEM 0x3F000000

extern void malloc_initialize();

extern int kernel_rb_main(int * counter , void * mytree_in , struct mynode ** mn_in , char * glob_mtx);

#define STACKSIZ ((8192 *2) + CONFIG_TEST_EXTRA_STACKSIZE)

K_THREAD_STACK_ARRAY_DEFINE(blasch_stacks, 1 , STACKSIZ);

extern int bs_thread(void *tid_ptr);

void *  shr_addr = BASE_SHMEM;

#define MAX_THREADS 128
extern int _M4_threadsTableAllocated[MAX_THREADS];
enum request_type{
        COMPUTE_VRANLC,
        COMPUTE_RANDLC,
        COMPUTE_LOG,
	RESPOND_VRANLC,
	BLACKSCHOLES_REQ,
	OFFLOAD_MD5_THREAD,
	OFFLOAD_RBTREE

};
enum arg_type {
        CHAR,
        CHAR_P,
        DOUBLE,
        DOUBLE_P,
	INT

};
struct argument {
        uint32_t * location;
        uint32_t size;
        enum arg_type type;
};

struct shared_meta
{
        uint32_t count;
        uint32_t my_malloc_addr_curr;

};

volatile struct shared_meta const * shared_struct = (char*)BASE_SHMEM + 0x200000 - 0x100;

struct offload_struct{
        uint32_t new_request ;
	enum request_type type;
        struct argument args[8];
};
struct handshake
{
        uint32_t present;
        char arch[10];
};
struct shared_area
{
        volatile void * write_area;
        volatile void * read_area;
};
  typedef struct {
      unsigned int mantissa_low:32;     
      unsigned int mantissa_high:20;
      unsigned int exponent:11;        
      unsigned int sign:1;
    } tDoubleStruct;
int tid;





void main()
{
	printf("arm64 app started\n");
	volatile struct shared_area rw_buf = {
                .write_area = (void*)0x9f000000,
                .read_area  = (void*)0x90000000
        };
	*((uint32_t*)rw_buf.write_area) = 0x00000000 ;
	struct handshake hnsk = {
                .present = 0xE00E0EE0,
        };
	struct handshake in_hnsk;
//	malloc_initialize();	
	memcpy(hnsk.arch, "ARM",4);
	memcpy((void*)&in_hnsk,rw_buf.read_area,sizeof(struct shared_area)); 	
	if(in_hnsk.present  == 0x1FF1F11F)
        {
        	printf("Already other core %s present in memory.\n",in_hnsk.arch);
		memcpy(rw_buf.write_area,(void*)&hnsk,sizeof(struct shared_area));
	}
	else{
                printf("Attempting connection with other core ::\n");
                 static uint64_t l = 0;
		while(1)
                {
                        volatile struct handshake * other = (struct handshake*)rw_buf.read_area;
			if(other->present == 0x1FF1F11F)
			{
                                printf("Other core of type x86 now conected \n");
                        	break;
			}
			else
			{
				if(l % 9000000 == 0){
                                        printf("waiting for other core\n");
                        		memcpy((void*)rw_buf.write_area,(void*)&hnsk,sizeof(struct shared_area));
				}
                                l++;
			}
                }
        }
//	md5_main();	
	while(1)
	{
		struct offload_struct *  inp = (struct offload_struct *)rw_buf.read_area ;
		if(inp->new_request == 0xf00f0ff0)
		{
		if (inp->type == 0xDE)
		  {
			printf("x86 wants to go away , I am leaving too\n");
			break;
		  }

		else if(inp->type == 9)	{	
		   }
		  else if(inp->type == OFFLOAD_RBTREE)	{	
			printf("A request of type OFFLOAD_RBTREE came\n");
			//do the work here
		
				
			//indicate that you have consumed the message
			*(uint32_t*)inp = ~(0xF00F0FF0);
			
			//Start replying
			int *  ij = (int *) inp->args[0].location;
			struct rb_root* treeroot = (struct rb_root*)inp->args[1].location;
			struct mynode ** mn =( struct mynode **)inp->args[2].location;				       char * glob_mtx = (char *)inp->args[3].location;
			kernel_rb_main(ij , treeroot , mn , glob_mtx);
			

				
			void * write_pointer = (void*)((char*)rw_buf.write_area + 0x1000);
			


        		//memcpy((void*)rw_buf.write_area , (void*)&ofld_vranlc , sizeof(struct offload_struct) );				
		   }
		   
	     }
	}
	tid = 1;
	printf("ARM_kernel_exiting\n");
     	*((uint32_t*)rw_buf.read_area) = 0x00000000 ;
     	*((uint32_t*)rw_buf.write_area) = 0x00000000 ;
	while(1);
}
```

## src/mymalloc.c
```c
#include<stdio.h>
#include<stddef.h>
#include "mymalloc.h"

char * memory_malloc = 0x60000000;
struct block *freeList=(void*)0x60000000;

static char status = 0;

void malloc_initialize(){
 freeList->size=0x20000000-sizeof(struct block);
 freeList->free=1;
 freeList->next=NULL;
}

void split(struct block *fitting_slot,size_t size){
 struct block *new=(void*)((void*)fitting_slot+size+sizeof(struct block));
 new->size=(fitting_slot->size)-size-sizeof(struct block);
 new->free=1;
 new->next=fitting_slot->next;
 fitting_slot->size=size;
 fitting_slot->free=0;
 fitting_slot->next=new;
}


void *MyMalloc(size_t noOfBytes){
 struct block *curr,*prev;
 void *result;
 printf("MAlloc called for %lu bytes\n",noOfBytes);
 if(!(freeList->size) || (status == 0)){
  malloc_initialize();
  printf("Memory initialized\n");
  status = 1;
 }
 curr=freeList;
 while((((curr->size)<noOfBytes)||((curr->free)==0))&&(curr->next!=NULL)){
  prev=curr;
  curr=curr->next;
  //printf("One block checked\n");
 }
 if((curr->size)==noOfBytes){
  curr->free=0;
  result=(void*)(++curr);
  //printf("Exact fitting block allocated\n");
  return result;
 }
 else if((curr->size)>(noOfBytes+sizeof(struct block))){
  split(curr,noOfBytes);
  result=(void*)(++curr);
  //printf("Fitting block allocated with a split\n");
  return result;
 }
 else{
  result=NULL;
  //printf("Sorry. No sufficient memory to allocate\n");
  return result;
 }
}

void merge(){
 struct block *curr,*prev;
 curr=freeList;
 while((curr->next)!=NULL){
  if((curr->free) && (curr->next->free)){
   curr->size+=(curr->next->size)+sizeof(struct block);
   curr->next=curr->next->next;
  }
  prev=curr;
  curr=curr->next;
 }
}

void MyFree(void* ptr){
 if(((void*)memory_malloc<=ptr)&&(ptr<=(void*)(memory_malloc +0x30000000))){
  struct block* curr=ptr;
  --curr;
  curr->free=1;
  merge();
 }
 else printf("Please provide a valid pointer allocated by MyMalloc\n");
}
```

## src/rbtree-tst.c
```c
/*
 * =============================================================================
 *
 *       Filename:  rbtree-tst.c
 *
 *    Description:  rbtree testcase.
 *
 *        Created:  09/02/2012 11:39:34 PM
 *
 *         Author:  Fu Haiping (forhappy), haipingf@gmail.com
 *        Company:  ICT ( Institute Of Computing Technology, CAS )
 *
 * =============================================================================
 */

#include "rbtree.h"
#include <stdio.h>
#include <stdlib.h>
#include <unistd.h>
#include <string.h>

extern void malloc_initialize();

struct mynode {
  	struct rb_node node;
  	char *string;
};

struct rb_root mytree = RB_ROOT;

char * global_lock;

void MyLock(char *lock) {
    while (__atomic_test_and_set(lock,__ATOMIC_SEQ_CST) == 1)
	{
		printf("waiting for lock\n");
	}
}

void MyUnlock(char * lock)
{
        __atomic_clear(lock,__ATOMIC_RELAXED);
}


struct mynode * my_search(struct rb_root *root, char *string)
{
  	struct rb_node *node = root->rb_node;

  	while (node) {
  		struct mynode *data = container_of(node, struct mynode, node);
		int result;

		result = strcmp(string, data->string);

		if (result < 0)
  			node = node->rb_left;
		else if (result > 0)
  			node = node->rb_right;
		else
  			return data;
	}
	return NULL;
}

int my_insert(struct rb_root *root, struct mynode *data)
{
  	struct rb_node **new = &(root->rb_node), *parent = NULL;

  	/* Figure out where to put new node */
  	while (*new) {
  		struct mynode *this = container_of(*new, struct mynode, node);
  		int result = strcmp(data->string, this->string);

		parent = *new;
  		if (result < 0)
  			new = &((*new)->rb_left);
  		else if (result > 0)
  			new = &((*new)->rb_right);
  		else
  			return 0;
  	}

  	/* Add new node and rebalance tree. */
  	rb_link_node(&data->node, parent, new);
  	rb_insert_color(&data->node, root);

	return 1;
}

void my_free(struct mynode *node)
{
	if (node != NULL) {
		if (node->string != NULL) {
			MyFree(node->string);
			node->string = NULL;
		}
		MyFree(node);
		node = NULL;
	}
}

#define NUM_NODES 14000

int write_count =0 , read_count =0;

int kernel_rb_main(int * counter , struct rb_root * mytree_in , struct mynode ** mn_in , char * glob_mtx)
{

	struct mynode **mn = (struct mynode **)mn_in;
	global_lock = glob_mtx;
	/* *insert */
	int * i = counter;
	printf("insert node from 1 to NUM_NODES(32): \n");
	

	struct mynode *data = my_search(mytree_in, "10");
	/* *delete again*/
	static int num_deletions = 0;
	MyLock(global_lock);
	while(num_deletions < 500){
	for(int l = 0 ; l < NUM_NODES -20 ; l++){
		char text[8];
		sprintf(text,"%x",l); 
	        data = my_search(mytree_in, text);
	        if (data) {
               		rb_erase(&data->node, mytree_in);
	        	printf("delete node %d: \n",l);
                	my_free(data);
			num_deletions++;
			mn[l] = NULL;
			write_count++;	
//			printf("Num deletions are %d\n",num_deletions);
        	}
	}
	}
	
	MyUnlock(global_lock);
	/* *search */
	struct rb_node *node;
	printf("search all nodes: \n");
	for (node = rb_first(mytree_in); node; node = rb_next(node)){
		printf("key = %s\n", rb_entry(node, struct mynode, node)->string);
		read_count++;
	}
	int k = 0;
	for (node = rb_first(mytree_in); node; node = rb_next(node)){
		printf("key = %s\n", rb_entry(node, struct mynode, node)->string);
		read_count++;
		k++;
	}

	*(uint32_t*)0x9f000000 = 0x1a2b3c4d;
	printf("Leaving the RB tre fucntion\n");
	printf("The read count is  %d and write count is  %d\n",read_count,write_count);
	return 0;
}
```
