## prj.conf
```kconfig
#CONFIG_QEMU_UEFI_BOOT=y
#CONFIG_BUILD_OUTPUT_EFI=y
#CONFIG_SRAM_SIZE=405600
#CONFIG_INIT_STACKS=y
#CONFIG_ACPI=y
#CONFIG_PCIE=y
#CONFIG_PCIE_MSI=y
#CONFIG_PCIE_MSI_X=y
#CONFIG_PCIE_MSI_MULTI_VECTOR=y
#CONFIG_VIRTUALIZATION=y
#CONFIG_IVSHMEM=y
#CONFIG_CONSOLE_GETLINE=y
```

## src/ep.c
```c
#include <stdio.h>
#include <stdlib.h>
#include <pthread.h>
#include <zephyr/types.h>
#include <sys/time.h>

extern int md5_main();

enum request_type{
	COMPUTE_VRANLC,
	COMPUTE_RANDLC,
	COMPUTE_LOG,
	RESPOND_VRANLC,
	BLACKSCHOLES_REQ,

};
enum arg_type {
	CHAR,
	CHAR_P,
	DOUBLE,
	DOUBLE_P,
	INT
	
};
struct argument {
	uint32_t * location;
	uint32_t size;
	enum arg_type type;	
};

struct offload_struct{
	uint32_t new_request ;
	enum request_type type;
	struct argument args[8];
};

struct shared_area
{
        volatile void * write_area;
        volatile void * read_area;
};

struct handshake
{
        uint32_t  present;
        char arch[10];
};
volatile struct shared_area rw_buf; 

extern int freqmine_main(int argc, char **argv);


void vranlc_dist( int n, double *x, double a, double y[] ){

	printf("Size of double is %d\n",sizeof(double));

	struct offload_struct  ofld_vranlc ;
	ofld_vranlc.new_request = 0xF00F0FF0;
	void * write_pointer = (void*)((char*)rw_buf.write_area + 0x1000);
	
	*((int*)write_pointer)  = n; 
	ofld_vranlc.args[0].location =  (uint32_t*)((char*)write_pointer + 0x40000000);
	printf("Location of the int is %p\n",ofld_vranlc.args[0].location);
	write_pointer =  (void*)((char*)write_pointer +  sizeof(int));
	
	printf("Size after incrementing is %p\n",write_pointer);	
	*((double*)write_pointer) = *x;
        ofld_vranlc.args[1].location =  (uint32_t*)((char*)write_pointer + 0x40000000) ;
	printf("Location of the float pointer is %p\n",ofld_vranlc.args[1].location);
	write_pointer  =  (void*)((char*)write_pointer +  sizeof(double));
        
	*((double*)write_pointer) = a;
	ofld_vranlc.args[2].location =  (uint32_t*)((char*)write_pointer + 0x40000000) ;
	write_pointer  =  (void*)((char*)write_pointer +  sizeof(double));
	
	*((double*)write_pointer) = *y;	
        ofld_vranlc.args[3].location = (uint32_t*)((char*)write_pointer + 0x40000000)   ;
	
		
	ofld_vranlc.type = COMPUTE_VRANLC;
	ofld_vranlc.args[0].size = 1;
	ofld_vranlc.args[0].type = INT; 
	ofld_vranlc.args[1].size = 1;
        ofld_vranlc.args[1].type = DOUBLE;
	ofld_vranlc.args[2].size = 1;
        ofld_vranlc.args[2].type = DOUBLE;
	ofld_vranlc.args[3].size = 1;
        ofld_vranlc.args[3].type = DOUBLE;
	
	memcpy((void*)rw_buf.write_area , (void*)&ofld_vranlc , sizeof(struct offload_struct) );
	printf("Copied the sturct details\n");
	printf("Args are %d , %f , %f and %f\n", n,*x,a,*y);	
	int request_feedback = 1;
	while(1)
	{
		if((*((uint32_t*)rw_buf.write_area) == ~(0xF00F0FF0) ) && request_feedback )
		{
			printf("ARM has started calculating vranlc\n");
			request_feedback = 0;
		}
		else
		{
			struct offload_struct *  outp = (struct offload_struct *)rw_buf.read_area ;
			if(outp->new_request == 0xF00F0FF0)
			{
				*x = *(double*)outp->args[1].location;
				*y = *(double*)outp->args[3].location;
				printf("retrived values from ARM machine \n");
				break;
			}
			
		}

	}	
}
int main() 
{

  printf("x86 kernel started\n");
  rw_buf.write_area = (void*)0x50000000;
  rw_buf.read_area  = (void*)0x5f000000;
  struct handshake hnsk = {
                .present = 0x1FF1F11F,
        };
/*	for(int li = 0 ; li < 20 ; li++)
	{
		printf("char at %p is %c\n",((char *)rw_buf.read_area + li) , *((char *)rw_buf.read_area + li));
	}
*/	
        struct handshake in_hnsk;
        *((uint32_t*)rw_buf.write_area) = 0x00000000 ;
        memcpy(hnsk.arch, "x86",4);
        memcpy((void*)&in_hnsk,rw_buf.read_area,sizeof(struct shared_area));
        if(in_hnsk.present == 0xE00E0EE0)
        {
                printf("Already other core %s present in memory.\n",in_hnsk.arch);
                memcpy(rw_buf.write_area,(void*)&hnsk,sizeof(struct shared_area));
        }
	else{
                printf("Attempting connection with other core ::\n");
                static uint64_t l = 0;
                while(1)
                {
                        volatile struct handshake * other = (struct handshake*)rw_buf.read_area;
                        if(other->present == 0xE00E0EE0)
                        {
                                printf("Other core of type %s conected \n",other->arch);
                                break;
                        }
                        else
                        {
                                if(l % 9000000 == 0)
                                {
                                        printf("waiting for other core\n");
                                        memcpy(rw_buf.write_area,(void*)&hnsk,sizeof(struct shared_area));
                                }
                                l++;
                        }
                }
        }
	*((uint32_t*)rw_buf.read_area) = 0x00000000 ;
        *((uint32_t*)rw_buf.write_area) = 0x00000000 ;
	printf("x86_kernel_ shraed memory area exiting\n");
	struct timeval tv;
  gettimeofday(&tv,(void *)0);
  printf("Seconds recorded is %d \n\n",tv.tv_sec);
  md5_main();
    
  printf("Requesting the ARM kernel to shutdown\n");
  struct offload_struct shutdown;
  shutdown.new_request = 0xF00F0FF0;
  shutdown.type = 0xDE;
  memcpy((void*)rw_buf.write_area , (void*)&shutdown , sizeof(struct offload_struct) );

  gettimeofday(&tv,(void *)0);
  printf("Seconds recorded is %d \n",tv.tv_sec);
  memset((void*)0x30000000, 'n' , 8196);  
  printf("x86_kernel_exiting\n");
        *((uint32_t*)rw_buf.read_area) = 0x00000000 ;
//        *((uint32_t*)rw_buf.write_area) = 0x00000000 ;
  return 0;
}
```

## src/md5_bmark.c
```c
/*
 * Copyright (C) 2013 Michael Andersch <michael.andersch@mailbox.tu-berlin.de>
 *
 * This file is part of Starbench.
 *
 * Starbench is free software: you can redistribute it and/or modify
 * it under the terms of the GNU General Public License as published by
 * the Free Software Foundation, either version 3 of the License, or
 * (at your option) any later version.
 *
 * Starbench is distributed in the hope that it will be useful,
 * but WITHOUT ANY WARRANTY; without even the implied warranty of
 * MERCHANTABILITY or FITNESS FOR A PARTICULAR PURPOSE.  See the
 * GNU General Public License for more details.
 *
 * You should have received a copy of the GNU General Public License
 * along with Starbench.  If not, see <http://www.gnu.org/licenses/>.
 */


#include <stdio.h>
#include <stdlib.h>
#include <stdint.h>
#include <unistd.h>
#include <string.h>
#include <sys/time.h>
#include <pthread.h>


#include "md5.h"
#include "md5_bmark.h"

typedef struct timeval timer;

#define TIME(x) gettimeofday(&x, NULL)

/* Function declarations */
int initialize(md5bench_t* args);
int finalize(md5bench_t* args);
void run(md5bench_t* args);
void process(uint8_t* in, uint8_t* out, int bufsize);
void listInputs();
long timediff(timer* starttime, timer* finishtime);

static char* usage = "Usage: %s <options>\n"
                     "-i inputnum          choose input data set\n"
                     "-c iterations        specify benchmark iterations\n"
                     "-s                   show available input sets\n"
                     "-t                   number of threads\n"
                     "-p                   thread pinning\n"
                     "-h                   this help text\n";

// Input configurations
static data_t datasets[] = {
    {64, 512, 0},
    {64, 1024, 0},
    {64, 2048, 0},
    {64, 4096, 0},
    {128, 1024*512, 1},
    {128, 1024*1024, 1},
    {128, 1024*2048, 1},
    {128, 1024*4096, 1},
};

pthread_t* threads;
int next_buf = 0;

/*
*   Function: initialize
*   --------------------
*   To initialize the benchmark parameters. Generates the input buffers from random data.
*/
int initialize(md5bench_t* args) {
    int index = args->input_set;
    if(index < 0 || index >= sizeof(datasets)/sizeof(datasets[0])) {
        printf( "Invalid input set specified! Clamping to set 0\n");
        index = 0;
    }

    args->numinputs = datasets[index].numbufs;
    args->size = datasets[index].bufsize;
    args->inputs = (uint8_t**)calloc(args->numinputs, sizeof(uint8_t*));
    args->out = (uint8_t*)calloc(args->numinputs, DIGEST_SIZE);
    threads = (pthread_t*)calloc(args->numthreads, sizeof(pthread_t));
    if(args->inputs == NULL || args->out == NULL || threads == NULL) {
        fprintf(stderr, "Memory Allocation Error\n");
        return -1;
    }

    fprintf(stderr, "Reading input set: %d buffers, %d bytes per buffer\n", datasets[index].numbufs, datasets[index].bufsize);
    fprintf(stderr, "Using %d parallel threads\n", args->numthreads);

    // Now the input buffers need to be generated, for replicability, use same seed
    srand(datasets[index].rseed);

    for(int i = 0; i < args->numinputs; i++) {
        args->inputs[i] = (uint8_t*)malloc(sizeof(uint8_t)*datasets[index].bufsize);
        uint8_t* p = args->inputs[i];
        if(p == NULL) {
            printf("Memory Allocation Error here\n");
            return -1;
        }
        for(int j = 0; j < datasets[index].bufsize; j++)
            *p++ = rand() % 255;
    }

    return 0;
}

/*
*   Function: process
*   -----------------
*   Processes one input buffer, delivering the digest into out.
*/
void process(uint8_t* in, uint8_t* out, int bufsize) {
    MD5_CTX context;
    uint8_t digest[16];

    MD5_Init(&context);
    MD5_Update(&context, in, bufsize);
    MD5_Final(digest, &context);

    memcpy(out, digest, DIGEST_SIZE);
}

void* md5_thread(void* arg) {
    int buf_to_process;
    threadarg_t* args = (threadarg_t*)arg;


    while((buf_to_process = __sync_fetch_and_add(&next_buf, 1)) < args->numbufs) {
         printf("Processing buf %d\n", buf_to_process);
        process(args->in[buf_to_process], args->out + buf_to_process * DIGEST_SIZE, args->size);
    }

    return NULL;
}

/*
*   Function: run
*   --------------------
*   Main benchmarking function. If called, processes buffers with MD5
*   until no more buffers available. The resulting message digests
*   are written into consecutive locations in the preallocated output
*   buffer.
*/
void run(md5bench_t* args) {
    threadarg_t threadargs[args->numthreads];
    for(int iter = 0; iter < args->iterations; iter++) {
		next_buf = 0;
        for(int i = 0; i < args->numthreads; i++) {
            threadargs[i].in = args->inputs;
            threadargs[i].out = args->out;
            threadargs[i].size = args->size;
            threadargs[i].numbufs = args->numinputs;
            threadargs[i].tid = i;
            pthread_create(&threads[i], NULL, &md5_thread, &threadargs[i]);
        }

        for(int i = 0; i < args->numthreads; i++) {
            pthread_join(threads[i], NULL);
        }
    }
}

/*
*   Function: finalize
*   ------------------
*   Cleans up memory used by the benchmark for input and output buffers.
*/
int finalize(md5bench_t* args) {

    char outname[] = "output.txt";
    char buffer[64];
    int offset = 0;
    FILE* fp;

    if(args->outflag) {
        fp = fopen(outname, "w+");

        for(int i = 0; i < args->numinputs; i++) {
            sprintf(buffer, "Buffer %d has checksum", i);
            fwrite(buffer, sizeof(char), strlen(buffer)+1, fp);
            for(int j = 0; j < DIGEST_SIZE*2; j+=2) {
                sprintf(buffer+j, "%x", args->out[DIGEST_SIZE*i+j/2] & 0xf);
                sprintf(buffer+j+1, "%x", args->out[DIGEST_SIZE*i+j/2] & 0xf0);
            }
            buffer[32] = '\0';
            fwrite(buffer, sizeof(char), 32, fp);
            fputc('\n', fp);
        }

        fclose(fp);
    }

    if(args->inputs) {
        for(int i = 0; i < args->numinputs; i++) {
            if(args->inputs[i])
                free(args->inputs[i]);
        }

        free(args->inputs);
    }

    if(args->out)
        free(args->out);

	free(threads);

    return 0;
}

/*
*   Function: listInputs
*   --------------------
*   Lists all available input configurations of the benchmark on stderr.
*/
void listInputs() {
    double datasize_mb;
    printf( "Available input configurations:\n");

    for(int i = 0; i < sizeof(datasets)/sizeof(datasets[0]); i++) {
        datasize_mb = (double)(datasets[i].numbufs * datasets[i].bufsize)/1000000.0;
        printf( "Index %d: %d buffers of %d bytes, totalling %.1fMB\n", i, datasets[i].numbufs, datasets[i].bufsize, datasize_mb);
    }
}

/*
*   Function: timediff
*   ------------------
*   Compute the difference between timers starttime and finishtime in msecs.
*/
long timediff(timer* starttime, timer* finishtime)
{
    long msec;
    msec=(finishtime->tv_sec-starttime->tv_sec)*1000;
    msec+=(finishtime->tv_usec-starttime->tv_usec)/1000;
    return msec;
}

/** MAIN **/
int md5_main() {

    int opt;
    extern char* optarg;
    extern int optind;

    timer io_start, b_start, b_end;

    md5bench_t args;
    // Default values for benchmark params
    args.input_set = 0;
    args.iterations = 1;
    args.outflag = 0;
    args.numthreads = 1;
    args.pinning = 0;

    // Who we are
    printf(stderr, "StarBench - MD5 Kernel\n");
    args.input_set = 4;
    args.iterations = 40;
    args.numthreads = 2;
    args.pinning = 0;
         
     listInputs();

	if(args.iterations < 1 || args.numthreads < 1) {
		printf( "Bad argument given\n");
		exit(EXIT_FAILURE);
	}

    TIME(io_start);

    // Parameter initialization
    if(initialize(&args)) {
        printf( "Initialization Error\n");
        exit(EXIT_FAILURE);
    }

    TIME(b_start);

    run(&args);

    TIME(b_end);

    // Free memory
    if(finalize(&args)) {
		printf( "Finalization Error\n");
		exit(EXIT_FAILURE);
	}

    double io_time = (double)timediff(&io_start, &b_start)/1000;
    double b_time = (double)timediff(&b_start, &b_end)/1000;

    printf("\nI/O time: %.3f\nTime: %.3f\n", io_time, b_time);

    return 0;
}
```
