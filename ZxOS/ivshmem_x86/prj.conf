## prj.conf
```kconfig
CONFIG_STACK_CANARIES=n
CONFIG_INIT_STACKS=y
CONFIG_USERSPACE=y
#CONFIG_ZTEST=y
CONFIG_TEST_USERSPACE=y

CONFIG_PCIE=y
CONFIG_PCIE_MSI=y
CONFIG_PCIE_MSI_X=y
CONFIG_PCIE_MSI_MULTI_VECTOR=y

CONFIG_VIRTUALIZATION=y
CONFIG_IVSHMEM=y
```

## x86_config_basic_ivshmem.conf
```kconfig
# CONFIG_GPIO is not set
# CONFIG_SPI is not set
# CONFIG_I2C is not set
# CONFIG_KSCAN is not set
# CONFIG_WIFI is not set
# CONFIG_MODEM is not set
# CONFIG_UART_INTERRUPT_DRIVEN is not set
# CONFIG_BUILD_OUTPUT_BIN is not set
CONFIG_BOARD="qemu_x86"
CONFIG_KERNEL_VM_SIZE=0x800000
CONFIG_MULTIBOOT=y
CONFIG_MULTIBOOT_INFO=y
CONFIG_MULTIBOOT_MEMMAP=y
CONFIG_QEMU_ICOUNT=y
CONFIG_QEMU_ICOUNT_SHIFT=5
CONFIG_X86_PC_COMPATIBLE=y
# CONFIG_HAVE_CUSTOM_LINKER_SCRIPT is not set
CONFIG_X86_EXTRA_PAGE_TABLE_PAGES=0
CONFIG_SOC="ia32"
# CONFIG_PCIE_MMIO_CFG is not set
CONFIG_SYS_CLOCK_HW_CYCLES_PER_SEC=25000000
CONFIG_X86_VERY_EARLY_CONSOLE=y

#
# Modules
#

#
# Available modules.
#

#
# CANopenNode (/home/ashwin/zephyrproject/modules/lib/canopennode)
#
CONFIG_ZEPHYR_CANOPENNODE_MODULE=y
# end of CANopenNode (/home/ashwin/zephyrproject/modules/lib/canopennode)

#
# hal_gigadevice (/home/ashwin/zephyrproject/modules/hal/gigadevice)
#
CONFIG_ZEPHYR_HAL_GIGADEVICE_MODULE=y
# end of hal_gigadevice (/home/ashwin/zephyrproject/modules/hal/gigadevice)

#
# hal_nordic (/home/ashwin/zephyrproject/modules/hal/nordic)
#
CONFIG_ZEPHYR_HAL_NORDIC_MODULE=y
# end of hal_nordic (/home/ashwin/zephyrproject/modules/hal/nordic)

#
# hal_nxp (/home/ashwin/zephyrproject/modules/hal/nxp)
#
CONFIG_ZEPHYR_HAL_NXP_MODULE=y
# end of hal_nxp (/home/ashwin/zephyrproject/modules/hal/nxp)

#
# loramac-node (/home/ashwin/zephyrproject/modules/lib/loramac-node)
#
CONFIG_ZEPHYR_LORAMAC_NODE_MODULE=y
# CONFIG_HAS_SEMTECH_RADIO_DRIVERS is not set
# end of loramac-node (/home/ashwin/zephyrproject/modules/lib/loramac-node)

#
# lz4 (/home/ashwin/zephyrproject/modules/lib/lz4)
#
CONFIG_ZEPHYR_LZ4_MODULE=y
# CONFIG_LZ4 is not set
# end of lz4 (/home/ashwin/zephyrproject/modules/lib/lz4)

#
# mbedtls (/home/ashwin/zephyrproject/modules/crypto/mbedtls)
#
CONFIG_ZEPHYR_MBEDTLS_MODULE=y
# CONFIG_MBEDTLS is not set
# end of mbedtls (/home/ashwin/zephyrproject/modules/crypto/mbedtls)

#
# nanopb (/home/ashwin/zephyrproject/modules/lib/nanopb)
#
CONFIG_ZEPHYR_NANOPB_MODULE=y
# CONFIG_NANOPB is not set
# end of nanopb (/home/ashwin/zephyrproject/modules/lib/nanopb)

#
# sof (/home/ashwin/zephyrproject/modules/audio/sof)
#
# CONFIG_DEBUG is not set
CONFIG_ZEPHYR_SOF_MODULE=y
# end of sof (/home/ashwin/zephyrproject/modules/audio/sof)

#
# tflite-micro (/home/ashwin/zephyrproject/modules/lib/tflite-micro)
#
# CONFIG_TENSORFLOW_LITE_MICRO is not set
CONFIG_ZEPHYR_TFLITE_MICRO_MODULE=y
# end of tflite-micro (/home/ashwin/zephyrproject/modules/lib/tflite-micro)

#
# TraceRecorder (/home/ashwin/zephyrproject/modules/debug/TraceRecorder)
#
CONFIG_ZEPHYR_TRACERECORDER_MODULE=y
# end of TraceRecorder (/home/ashwin/zephyrproject/modules/debug/TraceRecorder)

#
# trusted-firmware-m (/home/ashwin/zephyrproject/modules/tee/tf-m/trusted-firmware-m)
#
CONFIG_ZEPHYR_TRUSTED_FIRMWARE_M_MODULE=y
CONFIG_ROM_START_OFFSET=0
# end of trusted-firmware-m (/home/ashwin/zephyrproject/modules/tee/tf-m/trusted-firmware-m)

#
# zscilib (/home/ashwin/zephyrproject/modules/lib/zscilib)
#
# CONFIG_ZSL is not set
CONFIG_ZEPHYR_ZSCILIB_MODULE=y
# end of zscilib (/home/ashwin/zephyrproject/modules/lib/zscilib)

#
# Optional modules. Make sure they're installed, via the project manifest.
#
# CONFIG_CIVETWEB is not set
# CONFIG_LIBMETAL is not set
# CONFIG_HAS_MEC_HAL is not set
# CONFIG_OPENAMP is not set
# CONFIG_SOF is not set
# CONFIG_MIPI_SYST_LIB is not set
# CONFIG_HAS_TELINK_DRIVERS is not set
# CONFIG_TINYCBOR is not set
# CONFIG_TINYCRYPT is not set
# CONFIG_MCUBOOT_BOOTUTIL_LIB is not set

#
# Unavailable modules, please install those via the project manifest.
#

#
# FFF module not available.
#
# end of Modules

CONFIG_QEMU_TARGET=y
# CONFIG_NET_DRIVERS is not set
CONFIG_BOARD_QEMU_X86=y
# CONFIG_BOARD_QEMU_X86_64 is not set
# CONFIG_BOARD_QEMU_X86_TINY is not set

#
# Board Options
#
# CONFIG_QEMU_ICOUNT_SLEEP is not set
CONFIG_QEMU_IVSHMEM_PLAIN_MEM_SIZE=1
# end of Board Options

# CONFIG_SOC_APOLLO_LAKE is not set
# CONFIG_SOC_ATOM is not set
# CONFIG_SOC_ELKHART_LAKE is not set
CONFIG_SOC_IA32=y
# CONFIG_SOC_LAKEMONT is not set

#
# Hardware Configuration
#
# CONFIG_SOC_LOG_LEVEL_OFF is not set
# CONFIG_SOC_LOG_LEVEL_ERR is not set
# CONFIG_SOC_LOG_LEVEL_WRN is not set
CONFIG_SOC_LOG_LEVEL_INF=y
# CONFIG_SOC_LOG_LEVEL_DBG is not set
CONFIG_SOC_LOG_LEVEL=3
# end of Hardware Configuration

#
# X86 Architecture Options
#
CONFIG_ARCH="x86"
CONFIG_CPU_ATOM=y
# CONFIG_X86_64 is not set

#
# x86 Features
#
CONFIG_X86_CPU_HAS_MMX=y
CONFIG_X86_CPU_HAS_SSE=y
CONFIG_X86_CPU_HAS_SSE2=y
CONFIG_X86_CPU_HAS_SSE3=y
# end of x86 Features

CONFIG_SRAM_OFFSET=0x100000
CONFIG_KERNEL_VM_OFFSET=0x100000
CONFIG_MAX_IRQ_LINES=128
CONFIG_PIC_DISABLE=y
# CONFIG_ACPI is not set
CONFIG_X86_MEMMAP=y
CONFIG_X86_MEMMAP_ENTRIES=64
# CONFIG_MULTIBOOT_FRAMEBUF is not set
CONFIG_EXCEPTION_DEBUG=y
CONFIG_X86_MMU=y
CONFIG_X86_MAX_ADDITIONAL_MEM_DOMAINS=3
CONFIG_DISABLE_SSBD=y
CONFIG_ENABLE_EXTENDED_IBRS=y
CONFIG_X86_BOUNDS_CHECK_BYPASS_MITIGATION=y
CONFIG_X86_KPTI=y
CONFIG_NESTED_INTERRUPTS=y

#
# Memory Layout Options
#
CONFIG_IDT_NUM_VECTORS=256
CONFIG_SET_GDT=y
CONFIG_GDT_DYNAMIC=y
# end of Memory Layout Options

#
# Processor Capabilities
#
CONFIG_X86_ENABLE_TSS=y
CONFIG_X86_STACK_PROTECTION=y
CONFIG_X86_USERSPACE=y
CONFIG_X86_PAE=y

#
# Architecture Floating Point Options
#
# CONFIG_X86_FP_USE_SOFT_FLOAT is not set
# end of Architecture Floating Point Options
# end of Processor Capabilities

CONFIG_X86_EXCEPTION_STACK_TRACE=y
CONFIG_MAIN_STACK_SIZE=1024
CONFIG_IDLE_STACK_SIZE=384
CONFIG_ISR_STACK_SIZE=2048
CONFIG_TEST_EXTRA_STACKSIZE=0
CONFIG_SYSTEM_WORKQUEUE_STACK_SIZE=1024
# end of X86 Architecture Options

CONFIG_X86=y
CONFIG_ARCH_IS_SET=y

#
# General Architecture Options
#
# CONFIG_ARCH_LOG_LEVEL_OFF is not set
# CONFIG_ARCH_LOG_LEVEL_ERR is not set
# CONFIG_ARCH_LOG_LEVEL_WRN is not set
CONFIG_ARCH_LOG_LEVEL_INF=y
# CONFIG_ARCH_LOG_LEVEL_DBG is not set
CONFIG_ARCH_LOG_LEVEL=3
# CONFIG_MPU_LOG_LEVEL_OFF is not set
# CONFIG_MPU_LOG_LEVEL_ERR is not set
# CONFIG_MPU_LOG_LEVEL_WRN is not set
CONFIG_MPU_LOG_LEVEL_INF=y
# CONFIG_MPU_LOG_LEVEL_DBG is not set
CONFIG_MPU_LOG_LEVEL=3
CONFIG_SRAM_SIZE=4096
CONFIG_SRAM_BASE_ADDRESS=0x0
CONFIG_FLASH_SIZE=4096
CONFIG_FLASH_BASE_ADDRESS=0x500000
CONFIG_HW_STACK_PROTECTION=y
CONFIG_USERSPACE=y
CONFIG_PRIVILEGED_STACK_SIZE=1024
CONFIG_KOBJECT_TEXT_AREA=256
CONFIG_KOBJECT_DATA_AREA_RESERVE_EXTRA_PERCENT=100
CONFIG_KOBJECT_RODATA_AREA_EXTRA_BYTES=16
# CONFIG_STACK_GROWS_UP is not set
CONFIG_MAX_THREAD_BYTES=2
CONFIG_DYNAMIC_OBJECTS=y

#
# Interrupt Configuration
#
# CONFIG_DYNAMIC_INTERRUPTS is not set
# CONFIG_GEN_ISR_TABLES is not set
# CONFIG_IRQ_OFFLOAD is not set
# end of Interrupt Configuration
# end of General Architecture Options

CONFIG_ARCH_HAS_TIMING_FUNCTIONS=y
CONFIG_ARCH_HAS_STACK_PROTECTION=y
CONFIG_ARCH_HAS_USERSPACE=y
CONFIG_ARCH_SUPPORTS_COREDUMP=y
CONFIG_ARCH_HAS_GDBSTUB=y
CONFIG_ARCH_HAS_THREAD_LOCAL_STORAGE=y
CONFIG_CPU_HAS_FPU=y
CONFIG_CPU_HAS_MMU=y
CONFIG_ARCH_HAS_DEMAND_PAGING=y
CONFIG_ARCH_HAS_RESERVED_PAGE_FRAMES=y
CONFIG_MMU=y
CONFIG_MMU_PAGE_SIZE=0x1000
CONFIG_KERNEL_VM_BASE=0x0
# CONFIG_DEMAND_PAGING is not set
CONFIG_SRAM_REGION_PERMISSIONS=y

#
# Floating Point Options
#
# CONFIG_FPU is not set
# end of Floating Point Options

#
# Cache Options
#
# CONFIG_CACHE_MANAGEMENT is not set
# end of Cache Options

CONFIG_TOOLCHAIN_HAS_BUILTIN_FFS=y

#
# General Kernel Options
#
# CONFIG_KERNEL_LOG_LEVEL_OFF is not set
# CONFIG_KERNEL_LOG_LEVEL_ERR is not set
# CONFIG_KERNEL_LOG_LEVEL_WRN is not set
CONFIG_KERNEL_LOG_LEVEL_INF=y
# CONFIG_KERNEL_LOG_LEVEL_DBG is not set
CONFIG_KERNEL_LOG_LEVEL=3
CONFIG_MULTITHREADING=y
CONFIG_NUM_COOP_PRIORITIES=16
CONFIG_NUM_PREEMPT_PRIORITIES=15
CONFIG_MAIN_THREAD_PRIORITY=0
CONFIG_COOP_ENABLED=y
CONFIG_PREEMPT_ENABLED=y
CONFIG_PRIORITY_CEILING=-127
CONFIG_NUM_METAIRQ_PRIORITIES=0
# CONFIG_SCHED_DEADLINE is not set
CONFIG_THREAD_STACK_INFO=y
# CONFIG_THREAD_CUSTOM_DATA is not set
CONFIG_THREAD_USERSPACE_LOCAL_DATA=y
CONFIG_ERRNO=y
# CONFIG_SCHED_DUMB is not set
CONFIG_SCHED_SCALABLE=y
# CONFIG_SCHED_MULTIQ is not set
CONFIG_WAITQ_SCALABLE=y
# CONFIG_WAITQ_DUMB is not set

#
# Kernel Debugging and Metrics
#
CONFIG_INIT_STACKS=y
CONFIG_BOOT_BANNER=y
CONFIG_BOOT_DELAY=0
# CONFIG_THREAD_MONITOR is not set
CONFIG_THREAD_NAME=y
CONFIG_THREAD_MAX_NAME_LEN=32
# CONFIG_THREAD_RUNTIME_STATS is not set
# end of Kernel Debugging and Metrics

#
# Work Queue Options
#
CONFIG_SYSTEM_WORKQUEUE_PRIORITY=-1
# CONFIG_SYSTEM_WORKQUEUE_NO_YIELD is not set
# end of Work Queue Options

#
# Atomic Operations
#
CONFIG_ATOMIC_OPERATIONS_BUILTIN=y
# end of Atomic Operations

#
# Timer API Options
#
CONFIG_TIMESLICING=y
CONFIG_TIMESLICE_SIZE=0
CONFIG_TIMESLICE_PRIORITY=0
# CONFIG_POLL is not set
# end of Timer API Options

#
# Other Kernel Object Options
#
# CONFIG_MEM_SLAB_TRACE_MAX_UTILIZATION is not set
CONFIG_NUM_MBOX_ASYNC_MSGS=10
CONFIG_NUM_PIPE_ASYNC_MSGS=10
# CONFIG_EVENTS is not set
CONFIG_KERNEL_MEM_POOL=y
CONFIG_HEAP_MEM_POOL_SIZE=0
# end of Other Kernel Object Options

CONFIG_SYS_CLOCK_TICKS_PER_SEC=100
CONFIG_SYS_CLOCK_EXISTS=y
CONFIG_TIMEOUT_64BIT=y
# CONFIG_XIP is not set

#
# Initialization Priorities
#
CONFIG_KERNEL_INIT_PRIORITY_OBJECTS=30
CONFIG_KERNEL_INIT_PRIORITY_DEFAULT=40
CONFIG_KERNEL_INIT_PRIORITY_DEVICE=50
CONFIG_APPLICATION_INIT_PRIORITY=90
# end of Initialization Priorities

#
# Security Options
#
# CONFIG_STACK_CANARIES is not set
CONFIG_STACK_POINTER_RANDOM=0
CONFIG_BOUNDS_CHECK_BYPASS_MITIGATION=y
# end of Security Options

CONFIG_MAX_DOMAIN_PARTITIONS=16
CONFIG_ARCH_MEM_DOMAIN_DATA=y
CONFIG_ARCH_MEM_DOMAIN_SYNCHRONOUS_API=y

#
# SMP Options
#
CONFIG_MP_NUM_CPUS=1
# end of SMP Options

CONFIG_TICKLESS_KERNEL=y
# end of General Kernel Options

CONFIG_HAS_DTS=y

#
# Device Drivers
#
# CONFIG_IEEE802154 is not set
# CONFIG_LORA is not set
CONFIG_CONSOLE=y
CONFIG_CONSOLE_INPUT_MAX_LINE_LEN=128
CONFIG_CONSOLE_HAS_DRIVER=y
# CONFIG_CONSOLE_HANDLER is not set
CONFIG_CONSOLE_INIT_PRIORITY=60
CONFIG_UART_CONSOLE=y
# CONFIG_UART_CONSOLE_DEBUG_SERVER_HOOKS is not set
# CONFIG_UART_CONSOLE_MCUMGR is not set
# CONFIG_RAM_CONSOLE is not set
# CONFIG_IPM_CONSOLE_SENDER is not set
# CONFIG_IPM_CONSOLE_RECEIVER is not set
# CONFIG_UART_PIPE is not set
# CONFIG_UART_MCUMGR is not set
# CONFIG_UART_CONSOLE_LOG_LEVEL_OFF is not set
# CONFIG_UART_CONSOLE_LOG_LEVEL_ERR is not set
# CONFIG_UART_CONSOLE_LOG_LEVEL_WRN is not set
CONFIG_UART_CONSOLE_LOG_LEVEL_INF=y
# CONFIG_UART_CONSOLE_LOG_LEVEL_DBG is not set
CONFIG_UART_CONSOLE_LOG_LEVEL=3
# CONFIG_GSM_MUX is not set
# CONFIG_EC_HOST_CMD_PERIPH is not set
# CONFIG_MDIO is not set
CONFIG_SERIAL=y

#
# Capabilities
#
CONFIG_SERIAL_HAS_DRIVER=y
CONFIG_SERIAL_SUPPORT_INTERRUPT=y
CONFIG_SERIAL_INIT_PRIORITY=50
CONFIG_UART_USE_RUNTIME_CONFIGURE=y
# CONFIG_UART_LINE_CTRL is not set
# CONFIG_UART_DRV_CMD is not set
# CONFIG_UART_WIDE_DATA is not set

#
# Serial Drivers
#
CONFIG_UART_NS16550=y
# CONFIG_UART_NS16750 is not set
# CONFIG_UART_NS16550_ACCESS_WORD_ONLY is not set

#
# NS16550 Workarounds
#
# end of NS16550 Workarounds

# CONFIG_UART_ITE_IT8XXX2 is not set
# CONFIG_UART_ALTERA_JTAG is not set
# CONFIG_UART_PL011 is not set
# CONFIG_UART_XLNX_UARTLITE is not set

#
# Interrupt Controllers
#
# CONFIG_SWERV_PIC is not set
CONFIG_LOAPIC=y
CONFIG_LOAPIC_BASE_ADDRESS=0xFEE00000
# CONFIG_X2APIC is not set
# CONFIG_LOAPIC_SPURIOUS_VECTOR is not set
CONFIG_IOAPIC=y
CONFIG_IOAPIC_MASK_RTE=y
# CONFIG_INTC_ESP32 is not set
# end of Interrupt Controllers

#
# Timer Drivers
#
CONFIG_TIMER_HAS_64BIT_CYCLE_COUNTER=y
CONFIG_TIMER_READS_ITS_FREQUENCY_AT_RUNTIME=y
# CONFIG_SYSTEM_CLOCK_SLOPPY_IDLE is not set
CONFIG_SYSTEM_CLOCK_INIT_PRIORITY=0
CONFIG_TICKLESS_CAPABLE=y
# CONFIG_APIC_TIMER is not set
# CONFIG_APIC_TSC_DEADLINE_TIMER is not set
CONFIG_HPET_TIMER=y
# end of Timer Drivers

# CONFIG_ENTROPY_GENERATOR is not set
CONFIG_PCIE=y
# CONFIG_PCIE_LOG_LEVEL_OFF is not set
# CONFIG_PCIE_LOG_LEVEL_ERR is not set
# CONFIG_PCIE_LOG_LEVEL_WRN is not set
CONFIG_PCIE_LOG_LEVEL_INF=y
# CONFIG_PCIE_LOG_LEVEL_DBG is not set
CONFIG_PCIE_LOG_LEVEL=3
# CONFIG_PCIE_CONTROLLER is not set
CONFIG_PCIE_MSI=y
CONFIG_PCIE_MSI_MULTI_VECTOR=y
CONFIG_PCIE_MSI_X=y
# CONFIG_PCIE_PTM is not set
# CONFIG_PCIE_ENDPOINT is not set
# CONFIG_SHARED_IRQ is not set
# CONFIG_I2S is not set
# CONFIG_PWM is not set
# CONFIG_PINMUX is not set
# CONFIG_ADC is not set
# CONFIG_DAC is not set
# CONFIG_WATCHDOG is not set
# CONFIG_CLOCK_CONTROL is not set
# CONFIG_PTP_CLOCK is not set
# CONFIG_IPM is not set
# CONFIG_FLASH is not set
# CONFIG_SENSOR is not set
# CONFIG_COUNTER is not set
# CONFIG_DMA is not set
# CONFIG_USB_DEVICE_DRIVER is not set
# CONFIG_CRYPTO is not set
# CONFIG_DISPLAY is not set
# CONFIG_LED_STRIP is not set
# CONFIG_LED is not set
# CONFIG_CAN is not set
# CONFIG_AUDIO is not set
# CONFIG_NEURAL_NET_ACCEL is not set
# CONFIG_HWINFO is not set
# CONFIG_ESPI is not set
# CONFIG_PS2 is not set
# CONFIG_VIDEO is not set
# CONFIG_EEPROM is not set
# CONFIG_PECI is not set
# CONFIG_PECI_INTERRUPT_DRIVEN is not set
# CONFIG_REGULATOR is not set
# CONFIG_MEMC is not set
CONFIG_VIRTUALIZATION=y
CONFIG_IVSHMEM=y
CONFIG_IVSHMEM_DEV_NAME="IVSHMEM"
# CONFIG_IVSHMEM_LOG_LEVEL_OFF is not set
# CONFIG_IVSHMEM_LOG_LEVEL_ERR is not set
# CONFIG_IVSHMEM_LOG_LEVEL_WRN is not set
CONFIG_IVSHMEM_LOG_LEVEL_INF=y
# CONFIG_IVSHMEM_LOG_LEVEL_DBG is not set
CONFIG_IVSHMEM_LOG_LEVEL=3
# CONFIG_IVSHMEM_DOORBELL is not set
# CONFIG_EDAC is not set
# CONFIG_PM_CPU_OPS is not set

#
# Miscellaneous Drivers
#
# end of Miscellaneous Drivers

# CONFIG_DISK_DRIVERS is not set
# CONFIG_CACHE is not set
# CONFIG_SYSCON is not set
# CONFIG_BBRAM is not set
# CONFIG_FPGA is not set
# CONFIG_PINCTRL is not set
# CONFIG_MBOX is not set
# end of Device Drivers

#
# C Library
#
CONFIG_SUPPORT_MINIMAL_LIBC=y
CONFIG_MINIMAL_LIBC=y
# CONFIG_NEWLIB_LIBC is not set
# CONFIG_EXTERNAL_LIBC is not set
CONFIG_MINIMAL_LIBC_MALLOC=y
CONFIG_MINIMAL_LIBC_MALLOC_ARENA_SIZE=0
CONFIG_MINIMAL_LIBC_CALLOC=y
CONFIG_MINIMAL_LIBC_REALLOCARRAY=y
# CONFIG_MINIMAL_LIBC_LL_PRINTF is not set
CONFIG_MINIMAL_LIBC_OPTIMIZE_STRING_FOR_SIZE=y
# CONFIG_MINIMAL_LIBC_RAND is not set
CONFIG_STDOUT_CONSOLE=y
# end of C Library

#
# Additional libraries
#
# CONFIG_LVGL is not set

#
# OS Support Library
#
# CONFIG_JSON_LIBRARY is not set
# CONFIG_RING_BUFFER is not set
# CONFIG_BASE64 is not set
# CONFIG_SYS_HEAP_VALIDATE is not set
CONFIG_SYS_HEAP_ALLOC_LOOPS=3
# CONFIG_SYS_HEAP_RUNTIME_STATS is not set
# CONFIG_SYS_HEAP_SMALL_ONLY is not set
# CONFIG_SYS_HEAP_BIG_ONLY is not set
CONFIG_SYS_HEAP_AUTO=y
# CONFIG_PRINTK_SYNC is not set
# CONFIG_MPSC_PBUF is not set
# CONFIG_SHARED_MULTI_HEAP is not set
# CONFIG_REBOOT is not set
CONFIG_CBPRINTF_COMPLETE=y
# CONFIG_CBPRINTF_NANO is not set
CONFIG_CBPRINTF_FULL_INTEGRAL=y
# CONFIG_CBPRINTF_REDUCED_INTEGRAL is not set
# CONFIG_CBPRINTF_FP_SUPPORT is not set
# CONFIG_CBPRINTF_FP_A_SUPPORT is not set
# CONFIG_CBPRINTF_FP_ALWAYS_A is not set
CONFIG_CBPRINTF_N_SPECIFIER=y
# CONFIG_CBPRINTF_LIBC_SUBSTS is not set
# CONFIG_CBPRINTF_PACKAGE_LONGDOUBLE is not set
# CONFIG_CBPRINTF_STATIC_PACKAGE_CHECK_ALIGNMENT is not set
# end of OS Support Library

CONFIG_POSIX_MAX_FDS=4
# CONFIG_POSIX_API is not set
# CONFIG_PTHREAD_IPC is not set
# CONFIG_POSIX_CLOCK is not set
CONFIG_MAX_TIMER_COUNT=5
# CONFIG_POSIX_MQUEUE is not set
# CONFIG_EVENTFD is not set
# CONFIG_OPENAMP_RSC_TABLE is not set

#
# Util libraries
#
# CONFIG_FNMATCH is not set
# CONFIG_GETOPT is not set
# end of Util libraries

# CONFIG_SMF is not set
# end of Additional libraries

#
# Sub Systems and OS Services
#
# CONFIG_BT is not set

#
# Controller Area Network (CAN) bus subsystem
#
# CONFIG_ISOTP is not set
# end of Controller Area Network (CAN) bus subsystem

# CONFIG_CONSOLE_SUBSYS is not set
# CONFIG_CPLUSPLUS is not set

#
# System Monitoring Options
#
# CONFIG_THREAD_ANALYZER is not set
# end of System Monitoring Options

#
# Debugging Options
#
# CONFIG_STACK_USAGE is not set
CONFIG_PRINTK=y
CONFIG_PRINTK_BUFFER_SIZE=32
CONFIG_EARLY_CONSOLE=y
CONFIG_ASSERT=y
CONFIG_ASSERT_LEVEL=2
CONFIG_SPIN_VALIDATE=y
# CONFIG_FORCE_NO_ASSERT is not set
CONFIG_ASSERT_VERBOSE=y
# CONFIG_ASSERT_NO_FILE_INFO is not set
# CONFIG_ASSERT_NO_COND_INFO is not set
# CONFIG_ASSERT_NO_MSG_INFO is not set
# CONFIG_OVERRIDE_FRAME_POINTER_DEFAULT is not set
CONFIG_DEBUG_INFO=y
CONFIG_EXCEPTION_STACK_TRACE=y
# CONFIG_OPENOCD_SUPPORT is not set
# CONFIG_DEBUG_THREAD_INFO is not set
# CONFIG_DEBUG_COREDUMP is not set
# end of Debugging Options

# CONFIG_GDBSTUB is not set
# CONFIG_DISK_ACCESS is not set
# CONFIG_EMUL is not set
# CONFIG_CHARACTER_FRAMEBUFFER is not set

#
# File Systems
#
# CONFIG_FILE_SYSTEM is not set
# CONFIG_NVS is not set
# end of File Systems

#
# Inter Processor Communication
#
# CONFIG_RPMSG_SERVICE is not set
# CONFIG_IPC_SERVICE is not set
# end of Inter Processor Communication

# CONFIG_JWT is not set
CONFIG_LOG=y
# CONFIG_LOG_MODE_DEFERRED is not set
# CONFIG_LOG2_MODE_DEFERRED is not set
# CONFIG_LOG2_MODE_IMMEDIATE is not set
# CONFIG_LOG_MODE_IMMEDIATE is not set
CONFIG_LOG_MODE_MINIMAL=y
# CONFIG_LOG_FRONTEND is not set
CONFIG_LOG_DEFAULT_MINIMAL=y

#
# Logging levels filtering
#
CONFIG_LOG_DEFAULT_LEVEL=3
CONFIG_LOG_OVERRIDE_LEVEL=0
CONFIG_LOG_MAX_LEVEL=4
# end of Logging levels filtering

#
# Misc
#
CONFIG_LOG2_USE_VLA=y
# CONFIG_LOG2_ALWAYS_RUNTIME is not set
# CONFIG_LOG2_FMT_SECTION is not set
# end of Misc

#
# Device Management
#

#
# Host command handler subsystem
#
# CONFIG_EC_HOST_CMD is not set
# end of Host command handler subsystem

# CONFIG_MCUMGR is not set
# CONFIG_HAWKBIT is not set
# CONFIG_UPDATEHUB is not set
# CONFIG_OSDP is not set
# end of Device Management

# CONFIG_MODBUS is not set

#
# Networking
#
# CONFIG_NET_BUF is not set
# CONFIG_NETWORKING is not set
# end of Networking

#
# Portability
#
# end of Portability

#
# Power Management
#
# CONFIG_PM is not set
# CONFIG_PM_DEVICE is not set
# end of Power Management

# CONFIG_SHELL is not set
# CONFIG_STATS is not set
# CONFIG_USB_DEVICE_STACK is not set
# CONFIG_IMG_MANAGER is not set

#
# Random Number Generators
#
CONFIG_TEST_RANDOM_GENERATOR=y
CONFIG_TIMER_RANDOM_GENERATOR=y
# CONFIG_XOROSHIRO_RANDOM_GENERATOR is not set
# end of Random Number Generators

#
# Storage
#
# CONFIG_STREAM_FLASH is not set
# end of Storage

# CONFIG_SETTINGS is not set
# CONFIG_TASK_WDT is not set

#
# Testing
#
CONFIG_ZTEST=y
CONFIG_ZTEST_STACKSIZE=1024
# CONFIG_ZTEST_FAIL_FAST is not set
CONFIG_ZTEST_ASSERT_VERBOSE=1
CONFIG_ZTEST_THREAD_PRIORITY=-1
# CONFIG_ZTEST_TC_UTIL_USER_OVERRIDE is not set
# CONFIG_ZTEST_RETEST_IF_PASSED is not set
# CONFIG_ZTEST_FATAL_HOOK is not set
# CONFIG_ZTEST_ASSERT_HOOK is not set
# CONFIG_ZTEST_MOCKING is not set
CONFIG_TEST=y
CONFIG_HAS_COVERAGE_SUPPORT=y
# CONFIG_COVERAGE is not set
CONFIG_TEST_USERSPACE=y
CONFIG_TEST_LOGGING_DEFAULTS=y
CONFIG_TEST_LOGGING_FLUSH_AFTER_TEST=y
CONFIG_TEST_ENABLE_USERSPACE=y
# CONFIG_TEST_USERSPACE_WITHOUT_HW_STACK_PROTECTION is not set
CONFIG_TEST_HW_STACK_PROTECTION=y
# CONFIG_TEST_FLASH_DRIVERS is not set
# CONFIG_TEST_BUSY_SIM is not set
# end of Testing

# CONFIG_TIMING_FUNCTIONS is not set
# CONFIG_TRACING is not set
# end of Sub Systems and OS Services

CONFIG_TOOLCHAIN_ZEPHYR_0_13=y

#
# Build and Link Features
#

#
# Linker Options
#
# CONFIG_LINKER_ORPHAN_SECTION_PLACE is not set
CONFIG_LINKER_ORPHAN_SECTION_WARN=y
# CONFIG_LINKER_ORPHAN_SECTION_ERROR is not set
CONFIG_LD_LINKER_SCRIPT_SUPPORTED=y
CONFIG_LD_LINKER_TEMPLATE=y
CONFIG_KERNEL_ENTRY="__start"
CONFIG_LINKER_SORT_BY_ALIGNMENT=y
# CONFIG_SRAM_VECTOR_TABLE is not set
CONFIG_HAS_SRAM_OFFSET=y

#
# Linker Sections
#
# CONFIG_LINKER_USE_BOOT_SECTION is not set
# CONFIG_LINKER_USE_PINNED_SECTION is not set
CONFIG_LINKER_GENERIC_SECTIONS_PRESENT_AT_BOOT=y
# end of Linker Sections
# end of Linker Options

#
# Compiler Options
#
# CONFIG_CODING_GUIDELINE_CHECK is not set
# CONFIG_NATIVE_APPLICATION is not set
CONFIG_SIZE_OPTIMIZATIONS=y
# CONFIG_SPEED_OPTIMIZATIONS is not set
# CONFIG_DEBUG_OPTIMIZATIONS is not set
# CONFIG_NO_OPTIMIZATIONS is not set
CONFIG_COMPILER_COLOR_DIAGNOSTICS=y
CONFIG_COMPILER_OPT=""
# CONFIG_MISRA_SANE is not set
# end of Compiler Options

# CONFIG_ASSERT_ON_ERRORS is not set
# CONFIG_NO_RUNTIME_CHECKS is not set
CONFIG_RUNTIME_ERROR_CHECKS=y

#
# Build Options
#
CONFIG_KERNEL_BIN_NAME="zephyr"
CONFIG_OUTPUT_STAT=y
CONFIG_OUTPUT_DISASSEMBLY=y
# CONFIG_OUTPUT_DISASSEMBLE_ALL is not set
CONFIG_OUTPUT_PRINT_MEMORY_USAGE=y
# CONFIG_CLEANUP_INTERMEDIATE_FILES is not set
# CONFIG_BUILD_NO_GAP_FILL is not set
# CONFIG_BUILD_OUTPUT_HEX is not set
# CONFIG_BUILD_OUTPUT_EXE is not set
# CONFIG_BUILD_OUTPUT_S19 is not set
# CONFIG_BUILD_OUTPUT_STRIPPED is not set
# CONFIG_APPLICATION_DEFINED_SYSCALL is not set
# CONFIG_MAKEFILE_EXPORTS is not set
# CONFIG_BUILD_OUTPUT_META is not set
# end of Build Options

# CONFIG_WARN_EXPERIMENTAL is not set
# end of Build and Link Features

#
# Boot Options
#
# CONFIG_BOOTLOADER_MCUBOOT is not set
# CONFIG_BOOTLOADER_BOSSA is not set
# end of Boot Options

#
# Compatibility
#
CONFIG_COMPAT_INCLUDES=y
# end of Compatibility
```

## x86_ivshmem_basic_working_64bit.conf
```kconfig
# CONFIG_GPIO is not set
# CONFIG_SPI is not set
# CONFIG_I2C is not set
# CONFIG_KSCAN is not set
# CONFIG_WIFI is not set
# CONFIG_MODEM is not set
# CONFIG_UART_INTERRUPT_DRIVEN is not set
CONFIG_BUILD_OUTPUT_BIN=y
CONFIG_BOARD="qemu_x86_64"
CONFIG_KERNEL_VM_SIZE=0x800000
CONFIG_MULTIBOOT=y
# CONFIG_MULTIBOOT_INFO is not set
# CONFIG_MULTIBOOT_MEMMAP is not set
# CONFIG_QEMU_ICOUNT is not set
CONFIG_X86_PC_COMPATIBLE=y
# CONFIG_HAVE_CUSTOM_LINKER_SCRIPT is not set
CONFIG_X86_EXTRA_PAGE_TABLE_PAGES=0
CONFIG_SOC="ia32"
# CONFIG_PCIE_MMIO_CFG is not set
CONFIG_SYS_CLOCK_HW_CYCLES_PER_SEC=25000000
CONFIG_X86_VERY_EARLY_CONSOLE=y

#
# Modules
#

#
# Available modules.
#

#
# CANopenNode (/home/ashwin/zephyrproject/modules/lib/canopennode)
#
CONFIG_ZEPHYR_CANOPENNODE_MODULE=y
# end of CANopenNode (/home/ashwin/zephyrproject/modules/lib/canopennode)

#
# hal_gigadevice (/home/ashwin/zephyrproject/modules/hal/gigadevice)
#
CONFIG_ZEPHYR_HAL_GIGADEVICE_MODULE=y
# end of hal_gigadevice (/home/ashwin/zephyrproject/modules/hal/gigadevice)

#
# hal_nordic (/home/ashwin/zephyrproject/modules/hal/nordic)
#
CONFIG_ZEPHYR_HAL_NORDIC_MODULE=y
# end of hal_nordic (/home/ashwin/zephyrproject/modules/hal/nordic)

#
# hal_nxp (/home/ashwin/zephyrproject/modules/hal/nxp)
#
CONFIG_ZEPHYR_HAL_NXP_MODULE=y
# end of hal_nxp (/home/ashwin/zephyrproject/modules/hal/nxp)

#
# loramac-node (/home/ashwin/zephyrproject/modules/lib/loramac-node)
#
CONFIG_ZEPHYR_LORAMAC_NODE_MODULE=y
# CONFIG_HAS_SEMTECH_RADIO_DRIVERS is not set
# end of loramac-node (/home/ashwin/zephyrproject/modules/lib/loramac-node)

#
# lz4 (/home/ashwin/zephyrproject/modules/lib/lz4)
#
CONFIG_ZEPHYR_LZ4_MODULE=y
# CONFIG_LZ4 is not set
# end of lz4 (/home/ashwin/zephyrproject/modules/lib/lz4)

#
# mbedtls (/home/ashwin/zephyrproject/modules/crypto/mbedtls)
#
CONFIG_ZEPHYR_MBEDTLS_MODULE=y
# CONFIG_MBEDTLS is not set
# end of mbedtls (/home/ashwin/zephyrproject/modules/crypto/mbedtls)

#
# nanopb (/home/ashwin/zephyrproject/modules/lib/nanopb)
#
CONFIG_ZEPHYR_NANOPB_MODULE=y
# CONFIG_NANOPB is not set
# end of nanopb (/home/ashwin/zephyrproject/modules/lib/nanopb)

#
# sof (/home/ashwin/zephyrproject/modules/audio/sof)
#
# CONFIG_DEBUG is not set
CONFIG_ZEPHYR_SOF_MODULE=y
# end of sof (/home/ashwin/zephyrproject/modules/audio/sof)

#
# tflite-micro (/home/ashwin/zephyrproject/modules/lib/tflite-micro)
#
# CONFIG_TENSORFLOW_LITE_MICRO is not set
CONFIG_ZEPHYR_TFLITE_MICRO_MODULE=y
# end of tflite-micro (/home/ashwin/zephyrproject/modules/lib/tflite-micro)

#
# TraceRecorder (/home/ashwin/zephyrproject/modules/debug/TraceRecorder)
#
CONFIG_ZEPHYR_TRACERECORDER_MODULE=y
# end of TraceRecorder (/home/ashwin/zephyrproject/modules/debug/TraceRecorder)

#
# trusted-firmware-m (/home/ashwin/zephyrproject/modules/tee/tf-m/trusted-firmware-m)
#
CONFIG_ZEPHYR_TRUSTED_FIRMWARE_M_MODULE=y
CONFIG_ROM_START_OFFSET=0
# end of trusted-firmware-m (/home/ashwin/zephyrproject/modules/tee/tf-m/trusted-firmware-m)

#
# zscilib (/home/ashwin/zephyrproject/modules/lib/zscilib)
#
# CONFIG_ZSL is not set
CONFIG_ZEPHYR_ZSCILIB_MODULE=y
# end of zscilib (/home/ashwin/zephyrproject/modules/lib/zscilib)

#
# Optional modules. Make sure they're installed, via the project manifest.
#
# CONFIG_CIVETWEB is not set
# CONFIG_LIBMETAL is not set
# CONFIG_HAS_MEC_HAL is not set
# CONFIG_OPENAMP is not set
# CONFIG_SOF is not set
# CONFIG_MIPI_SYST_LIB is not set
# CONFIG_HAS_TELINK_DRIVERS is not set
# CONFIG_TINYCBOR is not set
# CONFIG_TINYCRYPT is not set
# CONFIG_MCUBOOT_BOOTUTIL_LIB is not set

#
# Unavailable modules, please install those via the project manifest.
#

#
# FFF module not available.
#
# end of Modules

CONFIG_QEMU_TARGET=y
# CONFIG_NET_DRIVERS is not set
# CONFIG_BOARD_QEMU_X86 is not set
CONFIG_BOARD_QEMU_X86_64=y
# CONFIG_BOARD_QEMU_X86_TINY is not set

#
# Board Options
#
CONFIG_QEMU_IVSHMEM_PLAIN_MEM_SIZE=1
# end of Board Options

# CONFIG_SOC_APOLLO_LAKE is not set
# CONFIG_SOC_ATOM is not set
# CONFIG_SOC_ELKHART_LAKE is not set
CONFIG_SOC_IA32=y
# CONFIG_SOC_LAKEMONT is not set

#
# Hardware Configuration
#
# end of Hardware Configuration

#
# X86 Architecture Options
#
CONFIG_ARCH="x86"
CONFIG_CPU_ATOM=y
CONFIG_X86_64=y

#
# x86 Features
#
CONFIG_X86_CPU_HAS_MMX=y
CONFIG_X86_CPU_HAS_SSE=y
CONFIG_X86_CPU_HAS_SSE2=y
CONFIG_X86_CPU_HAS_SSE3=y
CONFIG_X86_MMX=y
CONFIG_X86_SSE=y
CONFIG_X86_SSE2=y
# CONFIG_X86_SSE3 is not set
# CONFIG_X86_SSE_FP_MATH is not set
# end of x86 Features

CONFIG_SRAM_OFFSET=0x100000
CONFIG_KERNEL_VM_OFFSET=0x100000
CONFIG_MAX_IRQ_LINES=128
CONFIG_PIC_DISABLE=y
# CONFIG_ACPI is not set
# CONFIG_X86_MEMMAP is not set
# CONFIG_MULTIBOOT_FRAMEBUF is not set
CONFIG_X86_MMU=y
CONFIG_X86_MAX_ADDITIONAL_MEM_DOMAINS=3
CONFIG_DISABLE_SSBD=y
CONFIG_ENABLE_EXTENDED_IBRS=y
CONFIG_X86_BOUNDS_CHECK_BYPASS_MITIGATION=y
CONFIG_X86_KPTI=y
CONFIG_X86_USERSPACE=y
CONFIG_MAIN_STACK_SIZE=8192
CONFIG_IDLE_STACK_SIZE=4096
CONFIG_ISR_STACK_SIZE=16384
CONFIG_TEST_EXTRA_STACKSIZE=4096
CONFIG_SYSTEM_WORKQUEUE_STACK_SIZE=8192
CONFIG_X86_EXCEPTION_STACK_SIZE=4096
CONFIG_SCHED_IPI_VECTOR=34
CONFIG_TLB_IPI_VECTOR=35
CONFIG_ISR_DEPTH=4
CONFIG_ISR_SUBSTACK_SIZE=4096
# end of X86 Architecture Options

CONFIG_X86=y
CONFIG_ARCH_IS_SET=y

#
# General Architecture Options
#
CONFIG_64BIT=y
CONFIG_SRAM_SIZE=4096
CONFIG_SRAM_BASE_ADDRESS=0x0
CONFIG_FLASH_SIZE=4096
CONFIG_FLASH_BASE_ADDRESS=0x500000
# CONFIG_HW_STACK_PROTECTION is not set
CONFIG_USERSPACE=y
CONFIG_PRIVILEGED_STACK_SIZE=1024
CONFIG_KOBJECT_TEXT_AREA=256
CONFIG_KOBJECT_DATA_AREA_RESERVE_EXTRA_PERCENT=100
CONFIG_KOBJECT_RODATA_AREA_EXTRA_BYTES=16
# CONFIG_STACK_GROWS_UP is not set
CONFIG_MAX_THREAD_BYTES=2
CONFIG_DYNAMIC_OBJECTS=y

#
# Interrupt Configuration
#
# CONFIG_DYNAMIC_INTERRUPTS is not set
# CONFIG_GEN_ISR_TABLES is not set
# end of Interrupt Configuration
# end of General Architecture Options

CONFIG_ARCH_HAS_TIMING_FUNCTIONS=y
CONFIG_ARCH_HAS_STACK_PROTECTION=y
CONFIG_ARCH_HAS_USERSPACE=y
CONFIG_ARCH_SUPPORTS_COREDUMP=y
CONFIG_ARCH_HAS_THREAD_LOCAL_STORAGE=y
CONFIG_CPU_HAS_FPU=y
CONFIG_CPU_HAS_MMU=y
CONFIG_ARCH_HAS_DEMAND_PAGING=y
CONFIG_ARCH_HAS_RESERVED_PAGE_FRAMES=y
CONFIG_MMU=y
CONFIG_MMU_PAGE_SIZE=0x1000
CONFIG_KERNEL_VM_BASE=0x0
# CONFIG_DEMAND_PAGING is not set
CONFIG_SRAM_REGION_PERMISSIONS=y

#
# Floating Point Options
#
# CONFIG_FPU is not set
# end of Floating Point Options

#
# Cache Options
#
# CONFIG_CACHE_MANAGEMENT is not set
# end of Cache Options

CONFIG_TOOLCHAIN_HAS_BUILTIN_FFS=y

#
# General Kernel Options
#
CONFIG_MULTITHREADING=y
CONFIG_NUM_COOP_PRIORITIES=16
CONFIG_NUM_PREEMPT_PRIORITIES=15
CONFIG_MAIN_THREAD_PRIORITY=0
CONFIG_COOP_ENABLED=y
CONFIG_PREEMPT_ENABLED=y
CONFIG_PRIORITY_CEILING=-127
CONFIG_NUM_METAIRQ_PRIORITIES=0
# CONFIG_SCHED_DEADLINE is not set
# CONFIG_SCHED_CPU_MASK is not set
CONFIG_THREAD_STACK_INFO=y
# CONFIG_THREAD_CUSTOM_DATA is not set
CONFIG_THREAD_USERSPACE_LOCAL_DATA=y
CONFIG_ERRNO=y
CONFIG_SCHED_DUMB=y
# CONFIG_SCHED_SCALABLE is not set
# CONFIG_SCHED_MULTIQ is not set
# CONFIG_WAITQ_SCALABLE is not set
CONFIG_WAITQ_DUMB=y

#
# Kernel Debugging and Metrics
#
CONFIG_INIT_STACKS=y
CONFIG_BOOT_BANNER=y
CONFIG_BOOT_DELAY=0
# CONFIG_THREAD_MONITOR is not set
# CONFIG_THREAD_NAME is not set
# CONFIG_THREAD_RUNTIME_STATS is not set
# end of Kernel Debugging and Metrics

#
# Work Queue Options
#
CONFIG_SYSTEM_WORKQUEUE_PRIORITY=-1
# CONFIG_SYSTEM_WORKQUEUE_NO_YIELD is not set
# end of Work Queue Options

#
# Atomic Operations
#
CONFIG_ATOMIC_OPERATIONS_BUILTIN=y
# end of Atomic Operations

#
# Timer API Options
#
CONFIG_TIMESLICING=y
CONFIG_TIMESLICE_SIZE=0
CONFIG_TIMESLICE_PRIORITY=0
# CONFIG_POLL is not set
# end of Timer API Options

#
# Other Kernel Object Options
#
# CONFIG_MEM_SLAB_TRACE_MAX_UTILIZATION is not set
CONFIG_NUM_MBOX_ASYNC_MSGS=10
CONFIG_NUM_PIPE_ASYNC_MSGS=10
# CONFIG_EVENTS is not set
CONFIG_KERNEL_MEM_POOL=y
CONFIG_HEAP_MEM_POOL_SIZE=0
# end of Other Kernel Object Options

CONFIG_SYS_CLOCK_TICKS_PER_SEC=100
CONFIG_SYS_CLOCK_EXISTS=y
CONFIG_TIMEOUT_64BIT=y
# CONFIG_XIP is not set

#
# Initialization Priorities
#
CONFIG_KERNEL_INIT_PRIORITY_OBJECTS=30
CONFIG_KERNEL_INIT_PRIORITY_DEFAULT=40
CONFIG_KERNEL_INIT_PRIORITY_DEVICE=50
CONFIG_APPLICATION_INIT_PRIORITY=90
# end of Initialization Priorities

#
# Security Options
#
# CONFIG_STACK_CANARIES is not set
CONFIG_STACK_POINTER_RANDOM=0
CONFIG_BOUNDS_CHECK_BYPASS_MITIGATION=y
# end of Security Options

CONFIG_MAX_DOMAIN_PARTITIONS=16
CONFIG_ARCH_MEM_DOMAIN_DATA=y
CONFIG_ARCH_MEM_DOMAIN_SYNCHRONOUS_API=y

#
# SMP Options
#
CONFIG_USE_SWITCH=y
CONFIG_USE_SWITCH_SUPPORTED=y
CONFIG_SMP=y
# CONFIG_SMP_BOOT_DELAY is not set
CONFIG_MP_NUM_CPUS=2
CONFIG_SCHED_IPI_SUPPORTED=y
# CONFIG_TRACE_SCHED_IPI is not set
# end of SMP Options

CONFIG_TICKLESS_KERNEL=y
# end of General Kernel Options

CONFIG_HAS_DTS=y

#
# Device Drivers
#
# CONFIG_IEEE802154 is not set
# CONFIG_LORA is not set
CONFIG_CONSOLE=y
CONFIG_CONSOLE_INPUT_MAX_LINE_LEN=128
CONFIG_CONSOLE_HAS_DRIVER=y
# CONFIG_CONSOLE_HANDLER is not set
CONFIG_CONSOLE_INIT_PRIORITY=60
CONFIG_UART_CONSOLE=y
# CONFIG_UART_CONSOLE_DEBUG_SERVER_HOOKS is not set
# CONFIG_UART_CONSOLE_MCUMGR is not set
# CONFIG_RAM_CONSOLE is not set
# CONFIG_IPM_CONSOLE_SENDER is not set
# CONFIG_IPM_CONSOLE_RECEIVER is not set
# CONFIG_UART_PIPE is not set
# CONFIG_UART_MCUMGR is not set
# CONFIG_GSM_MUX is not set
# CONFIG_EC_HOST_CMD_PERIPH is not set
# CONFIG_MDIO is not set
CONFIG_SERIAL=y

#
# Capabilities
#
CONFIG_SERIAL_HAS_DRIVER=y
CONFIG_SERIAL_SUPPORT_INTERRUPT=y
CONFIG_SERIAL_INIT_PRIORITY=50
CONFIG_UART_USE_RUNTIME_CONFIGURE=y
# CONFIG_UART_LINE_CTRL is not set
# CONFIG_UART_DRV_CMD is not set
# CONFIG_UART_WIDE_DATA is not set

#
# Serial Drivers
#
CONFIG_UART_NS16550=y
# CONFIG_UART_NS16750 is not set
# CONFIG_UART_NS16550_ACCESS_WORD_ONLY is not set

#
# NS16550 Workarounds
#
# end of NS16550 Workarounds

# CONFIG_UART_ITE_IT8XXX2 is not set
# CONFIG_UART_ALTERA_JTAG is not set
# CONFIG_UART_PL011 is not set
# CONFIG_UART_XLNX_UARTLITE is not set

#
# Interrupt Controllers
#
# CONFIG_SWERV_PIC is not set
CONFIG_LOAPIC=y
CONFIG_LOAPIC_BASE_ADDRESS=0xFEE00000
# CONFIG_X2APIC is not set
# CONFIG_LOAPIC_SPURIOUS_VECTOR is not set
CONFIG_IOAPIC=y
CONFIG_IOAPIC_MASK_RTE=y
# CONFIG_INTC_ESP32 is not set
# end of Interrupt Controllers

#
# Timer Drivers
#
CONFIG_TIMER_HAS_64BIT_CYCLE_COUNTER=y
CONFIG_TIMER_READS_ITS_FREQUENCY_AT_RUNTIME=y
# CONFIG_SYSTEM_CLOCK_SLOPPY_IDLE is not set
CONFIG_SYSTEM_CLOCK_INIT_PRIORITY=0
CONFIG_TICKLESS_CAPABLE=y
# CONFIG_APIC_TIMER is not set
# CONFIG_APIC_TSC_DEADLINE_TIMER is not set
CONFIG_HPET_TIMER=y
# end of Timer Drivers

# CONFIG_ENTROPY_GENERATOR is not set
CONFIG_PCIE=y
# CONFIG_PCIE_CONTROLLER is not set
CONFIG_PCIE_MSI=y
CONFIG_PCIE_MSI_MULTI_VECTOR=y
CONFIG_PCIE_MSI_X=y
# CONFIG_PCIE_PTM is not set
# CONFIG_PCIE_ENDPOINT is not set
# CONFIG_SHARED_IRQ is not set
# CONFIG_I2S is not set
# CONFIG_PWM is not set
# CONFIG_PINMUX is not set
# CONFIG_ADC is not set
# CONFIG_DAC is not set
# CONFIG_WATCHDOG is not set
# CONFIG_CLOCK_CONTROL is not set
# CONFIG_PTP_CLOCK is not set
# CONFIG_IPM is not set
# CONFIG_FLASH is not set
# CONFIG_SENSOR is not set
# CONFIG_COUNTER is not set
# CONFIG_DMA is not set
# CONFIG_USB_DEVICE_DRIVER is not set
# CONFIG_CRYPTO is not set
# CONFIG_DISPLAY is not set
# CONFIG_LED_STRIP is not set
# CONFIG_LED is not set
# CONFIG_CAN is not set
# CONFIG_AUDIO is not set
# CONFIG_NEURAL_NET_ACCEL is not set
# CONFIG_HWINFO is not set
# CONFIG_ESPI is not set
# CONFIG_PS2 is not set
# CONFIG_VIDEO is not set
# CONFIG_EEPROM is not set
# CONFIG_PECI is not set
# CONFIG_PECI_INTERRUPT_DRIVEN is not set
# CONFIG_REGULATOR is not set
# CONFIG_MEMC is not set
CONFIG_VIRTUALIZATION=y
CONFIG_IVSHMEM=y
CONFIG_IVSHMEM_DEV_NAME="IVSHMEM"
# CONFIG_IVSHMEM_DOORBELL is not set
# CONFIG_EDAC is not set
# CONFIG_PM_CPU_OPS is not set

#
# Miscellaneous Drivers
#
# end of Miscellaneous Drivers

# CONFIG_DISK_DRIVERS is not set
# CONFIG_CACHE is not set
# CONFIG_SYSCON is not set
# CONFIG_BBRAM is not set
# CONFIG_FPGA is not set
# CONFIG_PINCTRL is not set
# CONFIG_MBOX is not set
# end of Device Drivers

#
# C Library
#
CONFIG_SUPPORT_MINIMAL_LIBC=y
CONFIG_MINIMAL_LIBC=y
# CONFIG_NEWLIB_LIBC is not set
# CONFIG_EXTERNAL_LIBC is not set
CONFIG_MINIMAL_LIBC_MALLOC=y
CONFIG_MINIMAL_LIBC_MALLOC_ARENA_SIZE=0
CONFIG_MINIMAL_LIBC_CALLOC=y
CONFIG_MINIMAL_LIBC_REALLOCARRAY=y
CONFIG_MINIMAL_LIBC_LL_PRINTF=y
CONFIG_MINIMAL_LIBC_OPTIMIZE_STRING_FOR_SIZE=y
# CONFIG_MINIMAL_LIBC_RAND is not set
CONFIG_STDOUT_CONSOLE=y
# end of C Library

#
# Additional libraries
#
# CONFIG_LVGL is not set

#
# OS Support Library
#
# CONFIG_JSON_LIBRARY is not set
# CONFIG_RING_BUFFER is not set
# CONFIG_BASE64 is not set
# CONFIG_SYS_HEAP_VALIDATE is not set
CONFIG_SYS_HEAP_ALLOC_LOOPS=3
# CONFIG_SYS_HEAP_RUNTIME_STATS is not set
CONFIG_PRINTK_SYNC=y
# CONFIG_MPSC_PBUF is not set
# CONFIG_SHARED_MULTI_HEAP is not set
# CONFIG_REBOOT is not set
CONFIG_CBPRINTF_COMPLETE=y
# CONFIG_CBPRINTF_NANO is not set
CONFIG_CBPRINTF_FULL_INTEGRAL=y
# CONFIG_CBPRINTF_REDUCED_INTEGRAL is not set
# CONFIG_CBPRINTF_FP_SUPPORT is not set
# CONFIG_CBPRINTF_FP_A_SUPPORT is not set
# CONFIG_CBPRINTF_FP_ALWAYS_A is not set
CONFIG_CBPRINTF_N_SPECIFIER=y
# CONFIG_CBPRINTF_LIBC_SUBSTS is not set
# CONFIG_CBPRINTF_PACKAGE_LONGDOUBLE is not set
# CONFIG_CBPRINTF_STATIC_PACKAGE_CHECK_ALIGNMENT is not set
# end of OS Support Library

CONFIG_POSIX_MAX_FDS=4
# CONFIG_POSIX_API is not set
# CONFIG_PTHREAD_IPC is not set
# CONFIG_POSIX_CLOCK is not set
CONFIG_MAX_TIMER_COUNT=5
# CONFIG_POSIX_MQUEUE is not set
# CONFIG_EVENTFD is not set
# CONFIG_OPENAMP_RSC_TABLE is not set

#
# Util libraries
#
# CONFIG_FNMATCH is not set
# CONFIG_GETOPT is not set
# end of Util libraries

# CONFIG_SMF is not set
# end of Additional libraries

#
# Sub Systems and OS Services
#

#
# Controller Area Network (CAN) bus subsystem
#
# CONFIG_ISOTP is not set
# end of Controller Area Network (CAN) bus subsystem

# CONFIG_CONSOLE_SUBSYS is not set
# CONFIG_CPLUSPLUS is not set

#
# System Monitoring Options
#
# CONFIG_THREAD_ANALYZER is not set
# end of System Monitoring Options

#
# Debugging Options
#
# CONFIG_STACK_USAGE is not set
CONFIG_PRINTK=y
CONFIG_PRINTK_BUFFER_SIZE=32
CONFIG_EARLY_CONSOLE=y
# CONFIG_ASSERT is not set
# CONFIG_FORCE_NO_ASSERT is not set
CONFIG_ASSERT_VERBOSE=y
# CONFIG_ASSERT_NO_FILE_INFO is not set
# CONFIG_ASSERT_NO_COND_INFO is not set
# CONFIG_ASSERT_NO_MSG_INFO is not set
# CONFIG_OVERRIDE_FRAME_POINTER_DEFAULT is not set
CONFIG_DEBUG_INFO=y
CONFIG_EXCEPTION_STACK_TRACE=y
# CONFIG_OPENOCD_SUPPORT is not set
# CONFIG_DEBUG_COREDUMP is not set
# end of Debugging Options

# CONFIG_DISK_ACCESS is not set
# CONFIG_EMUL is not set
# CONFIG_CHARACTER_FRAMEBUFFER is not set

#
# File Systems
#
# CONFIG_FILE_SYSTEM is not set
# CONFIG_NVS is not set
# end of File Systems

#
# Inter Processor Communication
#
# CONFIG_RPMSG_SERVICE is not set
# CONFIG_IPC_SERVICE is not set
# end of Inter Processor Communication

# CONFIG_JWT is not set
# CONFIG_LOG is not set

#
# Device Management
#

#
# Host command handler subsystem
#
# CONFIG_EC_HOST_CMD is not set
# end of Host command handler subsystem

# CONFIG_MCUMGR is not set
# CONFIG_HAWKBIT is not set
# CONFIG_UPDATEHUB is not set
# CONFIG_OSDP is not set
# end of Device Management

# CONFIG_MODBUS is not set

#
# Networking
#
# CONFIG_NET_BUF is not set
# CONFIG_NETWORKING is not set
# end of Networking

#
# Portability
#
# end of Portability

#
# Power Management
#
# CONFIG_PM is not set
# CONFIG_PM_DEVICE is not set
# end of Power Management

# CONFIG_SHELL is not set
# CONFIG_STATS is not set
# CONFIG_USB_DEVICE_STACK is not set
# CONFIG_IMG_MANAGER is not set

#
# Random Number Generators
#
CONFIG_TEST_RANDOM_GENERATOR=y
CONFIG_TIMER_RANDOM_GENERATOR=y
# CONFIG_XOROSHIRO_RANDOM_GENERATOR is not set
# end of Random Number Generators

#
# Storage
#
# CONFIG_STREAM_FLASH is not set
# end of Storage

# CONFIG_SETTINGS is not set
# CONFIG_TASK_WDT is not set

#
# Testing
#
# CONFIG_ZTEST is not set
# CONFIG_ZTEST_MOCKING is not set
# CONFIG_TEST is not set
CONFIG_HAS_COVERAGE_SUPPORT=y
# CONFIG_COVERAGE is not set
CONFIG_TEST_USERSPACE=y
CONFIG_TEST_LOGGING_FLUSH_AFTER_TEST=y
CONFIG_TEST_ENABLE_USERSPACE=y
# CONFIG_TEST_USERSPACE_WITHOUT_HW_STACK_PROTECTION is not set
# end of Testing

# CONFIG_TIMING_FUNCTIONS is not set
# CONFIG_TRACING is not set
# end of Sub Systems and OS Services

CONFIG_TOOLCHAIN_ZEPHYR_0_13=y

#
# Build and Link Features
#

#
# Linker Options
#
# CONFIG_LINKER_ORPHAN_SECTION_PLACE is not set
CONFIG_LINKER_ORPHAN_SECTION_WARN=y
# CONFIG_LINKER_ORPHAN_SECTION_ERROR is not set
CONFIG_LD_LINKER_SCRIPT_SUPPORTED=y
CONFIG_LD_LINKER_TEMPLATE=y
CONFIG_KERNEL_ENTRY="__start"
CONFIG_LINKER_SORT_BY_ALIGNMENT=y
# CONFIG_SRAM_VECTOR_TABLE is not set
CONFIG_HAS_SRAM_OFFSET=y

#
# Linker Sections
#
# CONFIG_LINKER_USE_BOOT_SECTION is not set
# CONFIG_LINKER_USE_PINNED_SECTION is not set
CONFIG_LINKER_GENERIC_SECTIONS_PRESENT_AT_BOOT=y
# end of Linker Sections
# end of Linker Options

#
# Compiler Options
#
# CONFIG_CODING_GUIDELINE_CHECK is not set
# CONFIG_NATIVE_APPLICATION is not set
CONFIG_SIZE_OPTIMIZATIONS=y
# CONFIG_SPEED_OPTIMIZATIONS is not set
# CONFIG_DEBUG_OPTIMIZATIONS is not set
# CONFIG_NO_OPTIMIZATIONS is not set
CONFIG_COMPILER_COLOR_DIAGNOSTICS=y
CONFIG_COMPILER_OPT=""
# CONFIG_MISRA_SANE is not set
# end of Compiler Options

# CONFIG_ASSERT_ON_ERRORS is not set
# CONFIG_NO_RUNTIME_CHECKS is not set
CONFIG_RUNTIME_ERROR_CHECKS=y

#
# Build Options
#
CONFIG_KERNEL_BIN_NAME="zephyr"
CONFIG_OUTPUT_STAT=y
CONFIG_OUTPUT_DISASSEMBLY=y
# CONFIG_OUTPUT_DISASSEMBLE_ALL is not set
CONFIG_OUTPUT_PRINT_MEMORY_USAGE=y
# CONFIG_CLEANUP_INTERMEDIATE_FILES is not set
# CONFIG_BUILD_NO_GAP_FILL is not set
# CONFIG_BUILD_OUTPUT_HEX is not set
# CONFIG_BUILD_OUTPUT_EFI is not set
# CONFIG_BUILD_OUTPUT_EXE is not set
# CONFIG_BUILD_OUTPUT_S19 is not set
# CONFIG_BUILD_OUTPUT_UF2 is not set
# CONFIG_BUILD_OUTPUT_STRIPPED is not set
# CONFIG_APPLICATION_DEFINED_SYSCALL is not set
# CONFIG_MAKEFILE_EXPORTS is not set
# CONFIG_BUILD_OUTPUT_META is not set
# end of Build Options

# CONFIG_WARN_EXPERIMENTAL is not set
# end of Build and Link Features

#
# Boot Options
#
# CONFIG_BOOTLOADER_MCUBOOT is not set
# CONFIG_BOOTLOADER_BOSSA is not set
# end of Boot Options

#
# Compatibility
#
CONFIG_COMPAT_INCLUDES=y
# end of Compatibility
```

## src/app.c
```c
#include <zephyr.h>
#include <drivers/virtualization/ivshmem.h>
#include <stdio.h>

struct shared_area
{
	volatile void * write_area;
	volatile void * read_area;
};

struct handshake
{
	uint32_t  present;
	char arch[10];
};
void main()
{
	printf("x86 kernel started\n");
	volatile struct shared_area rw_buf = {
		.write_area = (void*)0x50000000,
		.read_area  = (void*)0x5f000000
	};
//	*((uint32_t*)rw_buf.read_area) = 0x00454600 ;
	struct handshake hnsk = {
		.present = 0x1FF1F11F,
	};
	struct handshake in_hnsk;
	*((uint32_t*)rw_buf.write_area) = 0x00000000 ;
	memcpy(hnsk.arch, "x86",4);
	memcpy((void*)&in_hnsk,rw_buf.read_area,sizeof(struct shared_area));	
	if(in_hnsk.present == 0xE00E0EE0)
	{
		printf("Already other core %s present in memory.\n",in_hnsk.arch);	
		memcpy(rw_buf.write_area,(void*)&hnsk,sizeof(struct shared_area));
	}	
	else{
		printf("Attempting connection with other core ::\n");	
		static uint64_t l = 0;
		while(1)
		{
			volatile struct handshake * other = (struct handshake*)rw_buf.read_area;
			if(other->present == 0xE00E0EE0)
			{
				printf("Other core of type %s conected \n",other->arch);
				break;
			}
			else
			{
				if(l % 9000000 == 0)
				{
					printf("waiting for other core\n");
					memcpy(rw_buf.write_area,(void*)&hnsk,sizeof(struct shared_area));
				}
				l++;
			}
		}
	}
		
	printf("x86_kernel_exiting");
	*((uint32_t*)rw_buf.read_area) = 0x00000000 ;
	*((uint32_t*)rw_buf.write_area) = 0x00000000 ;
	while(1);
}
```
