## drivers/msg_layer/Kconfig
```kconfig
if POPCORN

config POPCORN_KMSG
	bool "Inter-kernel messaging layer"
	default y
	help
	  Enable support for various inter-kernel message passing
	  implementations

if POPCORN_KMSG

# Socket over Ethernet
config POPCORN_KMSG_SOCKET
	tristate "Over TCP/IP (DANGEROUS)"
	depends on INET && m
	default m
	help
	  Send Popcorn messages through TCP/IP sockets

# Debuging
config POPCORN_DEBUG_MSG_LAYER
	bool "Print debug messages"
	depends on POPCORN_DEBUG
	default n

endif # POPCORN_KMSG

endif # POPCORN
```

## kernel/Kconfig.popcorn
```kconfig
menu "Popcorn Distributed Execution Support"

# This is selected by all the architectures Popcorn supports
config ARCH_SUPPORTS_POPCORN
	bool

config POPCORN
	bool "Popcorn Distributed Execution Support"
	depends on ARCH_SUPPORTS_POPCORN
	default y
	help
		Enable or disable the Popcorn multi-kernel Linux support.

if POPCORN

config POPCORN_DEBUG
	bool "Log debug messages for Popcorn"
	default n
	help
		Enable or disable kernel messages that can help debug Popcorn issues.

config POPCORN_DEBUG_PROCESS_SERVER
	bool "Task migration"
	depends on POPCORN_DEBUG
	default n

config POPCORN_DEBUG_PAGE_SERVER
	bool "Page migration"
	depends on POPCORN_DEBUG
	default n

config POPCORN_DEBUG_VMA_SERVER
	bool "VMA handling"
	depends on POPCORN_DEBUG
	default n

config POPCORN_DEBUG_SYSCALL_SERVER
	bool "Syscall server"
	depends on POPCORN_DEBUG
	default n

config POPCORN_DEBUG_MVX_SERVER
	bool "MVX engine"
	depends on POPCORN_DEBUG
	default n

config POPCORN_DEBUG_VERBOSE
	bool "Log more debug messages"
	depends on POPCORN_DEBUG
	default n


config POPCORN_CHECK_SANITY
	bool "Perform extra-sanity checks"
	default y

config POPCORN_REMOTE_INFO
	bool "Single system image over multiple nodes"
	default n

#config POPCORN_POWER_SENSOR_X86
#	bool "Power sensor for x86"
#	depends on X86
#config POPCORN_POWER_SENSOR_ARM
#	bool "Power sensor for ARM"
#	depends on (ARM || ARM64)

config POPCORN_STAT
	bool "Collect performance statistics"
	default n
	help
		Collect basic performance metrics. The statistics are accessible from /proc/popcorn_stat

config POPCORN_STAT_PGFAULTS
	bool "Page faults handling"
	depends on POPCORN_STAT
	default n


comment "Popcorn is not currently supported on this architecture"
	depends on !ARCH_SUPPORTS_POPCORN

source msg_layer/Kconfig

endif # POPCORN

endmenu
```

## msg_layer/Kconfig
```kconfig
if POPCORN

config POPCORN_KMSG
	bool "Inter-kernel messaging layer"
	default y
	help
		Support various inter-kernel message passing implementations

if POPCORN_KMSG

# Socket over Ethernet
config POPCORN_KMSG_SOCKET
	tristate "Over TCP/IP"
	depends on INET && m
	default m
	help
		Communicate through sockets on IP on Ethernet

config POPCORN_KMSG_RDMA
	tristate "Over InfiniBand RDMA"
	depends on m && INFINIBAND
	default n
	help
		Mellanox Connect-X4 and Connect-X5
		
config POPCORN_KMSG_HDMA
	tristate "Over FPGA HDMA"
	depends on m && PCI
	default n
	help
		Bittware 250 SoC

# InfiniBand
#config POPCORN_KMSG_IB
#	tristate "Over InfiniBand"
#	depends on m && INFINIBAND
#	default n
#	help
#		Mellanox Connect-X4 and Connect-X5

# Dolphin PCIe
#config POPCORN_KMSG_DOLPHIN
#	tristate "Dolphin PCI-e"
#	depends on m
#	default n
#	help
#		Dolphin PCI-e PX-810
#
#config POPCORN_KMSG_DOLPHIN_DIS_PATH
#	string "Path to Dolphin software suite"
#	depends on POPCORN_KMSG_DOLPHIN
#	default "/opt/source/DIS/"

# Test and debug
config POPCORN_KMSG_TEST
	tristate "Build test modules"
	default n

config POPCORN_DEBUG_MSG_LAYER
	bool "Print debug message "
	depends on POPCORN_DEBUG
	default n

endif # POPCORN_KMSG

endif # POPCORN
```
